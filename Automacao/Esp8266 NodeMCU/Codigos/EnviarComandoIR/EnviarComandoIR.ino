#include <IRremoteESP8266.h> //INCLUSÃO DE BIBLIOTECA

IRsend irsend(14); //FUNÇÃO RESPONSÁVEL PELO MÉTODO DE ENVIO DO SINAL IR / UTILIZA O GPIO14(D5) - NAO MUDAR

int tamanho = 99; //TAMANHO DA LINHA RAW(68 BLOCOS)
int frequencia = 38; //FREQUÊNCIA DO SINAL IR(32KHz)

// BOTÃO LIGA / DESLIGA
unsigned int  POWER_TV_PHILCO[] = {8850,4450, 550,600, 550,550, 500,550, 550,550, 550,550, 550,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1600, 650};  // NEC FDC03F
// BOTÃO VOLUME MAIS
unsigned int  VOLMAIS_TV_PHILCO[] = {8800,4450, 500,650, 450,650, 450,600, 550,600, 500,600, 500,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1750, 500};  // UNKNOWN 85E09D61

// BOTÃO VOLUME MENOS
unsigned int  VOLMENOS_TV_PHILCO[] = {8850,4450, 500,600, 500,600, 550,550, 500,550, 600,550, 550,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1700, 500};  // NEC FD58A7
 
void setup(){
  irsend.begin(); //INICIALIZA A FUNÇÃO
  Serial.begin(115200); //INICIALIZA A PORTA SERIAL
}
void loop()
{
    
    char c = Serial.read(); //VARIÁVEL RESPONSÁVEL POR RECEBER O CARACTER DIGITADO NA JANELA SERIAL
    
    if (c == 'a'){ //SE CARACTER DIGITADO FOR IGUAL A "a", FAZ
       // irsend.sendRaw(POWER_TV_PHILCO,tamanho,frequencia);  // PARÂMETROS NECESSÁRIOS PARA ENVIO DO SINAL IR
        
         irsend.sendRaw(POWER_TV_PHILCO, sizeof(POWER_TV_PHILCO) / sizeof(POWER_TV_PHILCO[0]), frequencia);
        Serial.println("Comando enviado: Liga / Desliga");
        delay(50); // TEMPO(EM MILISEGUNDOS) DE INTERVALO ENTRE UM COMANDO E OUTRO
    }
    if (c == 'b'){ //SE CARACTER DIGITADO FOR IGUAL A "b", FAZ
               
         irsend.sendRaw(VOLMAIS_TV_PHILCO, sizeof(VOLMAIS_TV_PHILCO) / sizeof(VOLMAIS_TV_PHILCO[0]), frequencia);
        Serial.println("Comando enviado: Volume +");
        delay(50); // TEMPO(EM MILISEGUNDOS) DE INTERVALO ENTRE UM COMANDO E OUTRO
    }
    if (c == 'c'){ //SE CARACTER DIGITADO FOR IGUAL A "c", FAZ
               
         irsend.sendRaw(VOLMENOS_TV_PHILCO, sizeof(VOLMENOS_TV_PHILCO) / sizeof(VOLMENOS_TV_PHILCO[0]), frequencia);
        Serial.println("Comando enviado: Volume -");
        delay(50); // TEMPO(EM MILISEGUNDOS) DE INTERVALO ENTRE UM COMANDO E OUTRO
    }
  
}
