#include <IRremoteESP8266.h> //INCLUSÃO DE BIBLIOTECA

String readString;
IRsend LED_Infravermelho(10); //FUNÇÃO RESPONSÁVEL PELO MÉTODO DE ENVIO DO SINAL IR / UTILIZA O GPIO10(SD3)

#include <PubSubClient.h>
#include <ESP8266WiFi.h>
#include <ESP8266HTTPUpdateServer.h> //Biblioteca que cria o servico de atualizacÃ£o via wifi (ou Over The Air - OTA)
#include <ESP8266WebServer.h>

int frequencia = 38; //FREQUÊNCIA DO SINAL IR(32KHz)

// VARIAVEIS DA TV PHILCO
unsigned int  power_tv_philco[] = {8850, 4450, 550, 600, 550, 550, 500, 550, 550, 550, 550, 550, 550,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 1600, 650}; // NEC FDC03F
unsigned int  volume_mais_tv_philco[] = {8800, 4450, 500, 650, 450, 650, 450, 600, 550, 600, 500, 600, 500,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 1750, 500}; // UNKNOWN 85E09D61
unsigned int  volume_menos_tv_philco[] = {8850, 4450, 500, 600, 500, 600, 550, 550, 500, 550, 600, 550, 550,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 1700, 500}; // NEC FD58A7

// VARIAVEIS DO DENON  {5752, 9000, -4450, 600, -500, 600, -550, 600, -500, 700, -450, 600, -500, 600, -550, 550, -550, 600, -550, 550, -1650, 600, -1650, 600, -1650, 600, -550, 550, -1700, 550, -1700, 550, -1650
unsigned int  power_denon[] = {3300, 1750, 350, 500, 350, 500, 350, 1300, 400, 400, 450, 1250, 400,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 300, 500}; // UNKNOWN 9A7138C1
unsigned int  sleep_denon[] = {3300, 1700, 400, 450, 350, 500, 400, 1250, 400, 450, 400, 1250, 450,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 300, 550}; // UNKNOWN 9D036916
unsigned int  sky_denon[] = {3400, 1700, 400, 400, 450, 400, 400, 1200, 450, 450, 400, 1250, 450,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 300, 550}; // UNKNOWN 513DC322
unsigned int  dvd_denon[] = {3350, 1700, 400, 450, 350, 450, 400, 1300, 400, 400, 400, 1300, 400,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 350, 450}; // UNKNOWN 54C6DB8
unsigned int  bluray_denon[] = {3350, 1700, 400, 400, 450, 450, 350, 1300, 400, 450, 400, 1250, 400,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 400, 450}; // UNKNOWN 94176735
unsigned int  ps3_denon[] = {3350, 1700, 400, 450, 400, 400, 450, 1250, 400, 450, 400, 1250, 400,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 350, 500}; // UNKNOWN 3365CC0E
unsigned int  aux1_denon[] = {3350, 1650, 400, 450, 400, 450, 400, 1250, 400, 450, 400, 1300, 400,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 1150, 500}; // UNKNOWN AA8EAAEE
unsigned int  mediaplayer_denon[] = {3400, 1700, 400, 450, 400, 400, 450, 1200, 500, 350, 450, 1250, 400,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 300, 500}; // UNKNOWN 604FA3A2
unsigned int  tvaudio_denon[] = {3350, 1700, 450, 400, 400, 450, 350, 1300, 400, 450, 450, 1200, 400,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 450, 400}; // UNKNOWN 78372CFC
unsigned int  aux2_denon[] = {3350, 1700, 350, 450, 400, 450, 400, 1250, 400, 450, 400, 1250, 450,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 1150, 450}; // UNKNOWN BF5261A4
unsigned int  radio_denon[] = {3350, 1650, 450, 400, 400, 450, 450, 1200, 450, 400, 450, 1200, 450,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 1200, 500}; // UNKNOWN DA402832
unsigned int  usb_denon[] = {3350, 1700, 400, 450, 400, 450, 350, 1300, 400, 450, 400, 1250, 450,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 1150, 500}; // UNKNOWN 8A5679AE
unsigned int  cd_denon[] = {3300, 1750, 350, 450, 400, 450, 350, 1300, 400, 450, 350, 1350, 350,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 400, 450}; // UNKNOWN 3462E7BD
unsigned int  bluetooth_denon[] = {3300, 1700, 350, 500, 350, 450, 400, 1300, 350, 500, 350, 1300, 400,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 1200, 500}; // UNKNOWN 727E52F
unsigned int  heos_denon[] = {3300, 1700, 400, 450, 400, 450, 400, 1250, 400, 450, 450, 1200, 400,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 350, 450}; // UNKNOWN D39C58E4
unsigned int  mute_denon[] = {3350, 1650, 400, 500, 300, 500, 350, 1350, 350, 450, 400, 1250, 400,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 400, 450}; // UNKNOWN EF3858F5
unsigned int  volume_mais_denon[] = {3350, 1650, 400, 450, 400, 450, 350, 1300, 400, 450, 400, 1250, 400,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 350, 500}; // UNKNOWN 924FD4DC
unsigned int  volume_menos_denon[] = {3350, 1700, 400, 450, 400, 400, 450, 1250, 400, 400, 500, 1200, 450,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 350, 550}; // UNKNOWN FCD5027A
unsigned int  info_denon[] = {3300, 1700, 400, 450, 400, 450, 400, 1300, 400, 400, 400, 1300, 400,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 400, 450}; // UNKNOWN 31484082
unsigned int  option_denon[] = {3350, 1650, 450, 400, 450, 400, 450, 1250, 450, 350, 400, 1300, 400,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 400, 450}; // UNKNOWN F4997BEB
unsigned int  cima_denon[] = {3400, 1650, 400, 450, 400, 450, 350, 1300, 400, 450, 400, 1250, 400,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 1250, 450}; // UNKNOWN C0A735FD
unsigned int  baixo_denon[] = {3400, 1700, 400, 400, 450, 350, 450, 1250, 500, 400, 400, 1200, 450,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 1250, 400}; // UNKNOWN 4959BF04
unsigned int  direita_denon[] = {3350, 1700, 400, 400, 400, 450, 450, 1250, 400, 400, 450, 1250, 400,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 1200, 450}; // UNKNOWN 66923E3A
unsigned int  esquerda_denon[] = {3300, 1750, 350, 450, 400, 450, 400, 1300, 350, 450, 400, 1300, 350,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 1200, 450}; // UNKNOWN E34E32EB
unsigned int  setup_denon[] = {3350, 1750, 350, 400, 400, 500, 350, 1300, 350, 500, 350, 1300, 400,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 350, 450}; // UNKNOWN 3DE75718
unsigned int  back_denon[] = {3400, 1650, 400, 450, 400, 450, 400, 1250, 400, 450, 400, 1250, 450,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 350, 500}; // UNKNOWN 2A1047C0
unsigned int  tune_mais_denon[] = {3350, 1700, 400, 450, 400, 400, 400, 1300, 400, 400, 400, 1300, 450,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 350, 450}; // UNKNOWN 86ECA1B4
unsigned int  tune_menos_denon[] = {3350, 1750, 350, 450, 400, 450, 400, 1250, 400, 450, 400, 1250, 450,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 400, 400}; // UNKNOWN D56C6C87
unsigned int  play_denon[] = {3300, 1700, 400, 500, 350, 450, 400, 1250, 400, 450, 400, 1250, 450,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 300, 600}; // UNKNOWN 52213642
unsigned int  movie_denon[] = {3350, 1700, 350, 450, 400, 450, 400, 1250, 450, 400, 400, 1250, 450,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 1200, 500}; // UNKNOWN A7E802C1
unsigned int  music_denon[] = {3350, 1650, 400, 450, 400, 400, 450, 1300, 350, 450, 450, 1200, 450,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 1100, 550}; // UNKNOWN 95D7966D
unsigned int  game_denon[] = {3350, 1700, 400, 450, 350, 500, 400, 1250, 350, 500, 350, 1300, 400,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 1250, 450}; // UNKNOWN 2BEAB3F
unsigned int  pure_denon[] = {3350, 1700, 400, 400, 400, 450, 400, 1300, 400, 400, 400, 1300, 400,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 400, 450}; // UNKNOWN F1C80827


// VARIAVEIS DO AR
unsigned int  power_ar[] = {8950, 4400, 600, 550, 600, 550, 500, 600, 550, 550, 600, 600, 450,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 500, 600}; // NEC 3FA15E
unsigned int  umidificar_ar[] = {8850, 4550, 500, 550, 550, 650, 450, 600, 550, 550, 550, 650, 500,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 500, 650}; // UNKNOWN A7BE8BD2
unsigned int  sleep_ar[] = {8900, 4500, 500, 650, 500, 600, 500, 600, 550, 600, 500, 600, 500,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 550, 600}; // UNKNOWN DA89E118
unsigned int  velocidade_ar[] = {9000, 4450, 550, 600, 500, 550, 600, 550, 550, 550, 550, 600, 500,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 500, 600}; // NEC 3F21DE
unsigned int  horizontal_ar[] = {8950, 4550, 500, 600, 550, 550, 550, 600, 500, 600, 550, 550, 600,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 550, 600}; // NEC 3F41BE
unsigned int  vertical_ar[] = {9000, 4500, 550, 550, 500, 600, 550, 550, 550, 550, 600, 550, 600,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 500, 600}; // NEC 3FC13E



// VARIAVEIS DA SKY

unsigned int  power_sky[] = {9000, 4450, 600, 500, 600, 550, 550, 550, 600, 500, 650, 500, 600,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 1600, 600}; // NEC EF3AC5
unsigned int  mute_sky[] = {9000, 4450, 600, 550, 550, 550, 650, 500, 600, 500, 600, 500, 650,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 1650, 550}; // NEC EF7887
unsigned int  um_sky[] = {9050, 4400, 600, 500, 600, 550, 600, 500, 600, 500, 650, 500, 600,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 1600, 650}; // NEC EF02FD
unsigned int  dois_sky[] = {9050, 4500, 550, 550, 550, 600, 550, 550, 600, 550, 550, 550, 550,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 1650, 550}; // NEC EFC03F
unsigned int  tres_sky[] = {9050, 4450, 550, 550, 600, 550, 550, 550, 600, 550, 550, 550, 600,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 1650, 600}; // NEC EF40BF
unsigned int  quatro_sky[] = {9000, 4450, 650, 500, 550, 550, 600, 550, 550, 550, 600, 550, 600,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 1550, 600}; // NEC EF48B7
unsigned int  cinco_sky[] = {8950, 4500, 550, 550, 550, 600, 550, 550, 600, 500, 600, 550, 600,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 1600, 600}; // NEC EF6897
unsigned int  seis_sky[] = {8950, 4500, 550, 600, 550, 550, 550, 550, 600, 550, 600, 500, 600,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 1650, 600}; // NEC EF58A7
unsigned int  sete_sky[] = {8950, 4500, 550, 550, 550, 600, 600, 500, 650, 500, 550, 550, 600,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 1650, 600}; // NEC EFC837
unsigned int  oito_sky[] = {8950, 4500, 600, 550, 550, 550, 600, 550, 600, 500, 600, 500, 650,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 1600, 650}; // NEC EFE817
unsigned int  nove_sky[] = {8950, 4450, 550, 600, 550, 550, 600, 500, 600, 550, 600, 550, 550,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 1600, 600}; // NEC EFD827
unsigned int  zero_sky[] = {9000, 4450, 550, 550, 600, 500, 650, 500, 600, 500, 600, 550, 600,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 1600, 650}; // NEC EF2AD5
unsigned int  epg_sky[] = {8950, 4500, 550, 550, 550, 550, 600, 550, 600, 500, 600, 550, 600,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 1650, 650}; // NEC EF0AF5
unsigned int  sair_sky[] = {9050, 4450, 550, 550, 550, 550, 600, 550, 550, 550, 600, 500, 650,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 1500, 650}; // NEC EF38C7
unsigned int  menu_sky[] = {9000, 4450, 600, 550, 600, 550, 550, 550, 600, 500, 600, 550, 600,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 1600, 600}; // NEC EF08F7
unsigned int  info_sky[] = {8950, 4450, 550, 600, 550, 550, 550, 550, 600, 500, 650, 500, 550,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 1550, 650}; // NEC EF22DD
unsigned int  recall_sky[] = {350, 4450, 9000, 4450, 600, 550, 600, 500, 650, 500, 600, 500, 650,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 1600, 650}; // UNKNOWN 7E9B3A5D
unsigned int  cima_sky[] = {8950, 4400, 650, 450, 600, 550, 600, 500, 600, 500, 650, 500, 600,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 1550, 650}; // NEC EF12ED
unsigned int  baixo_sky[] = {8950, 4500, 650, 450, 600, 550, 600, 550, 550, 550, 600, 500, 600,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 1600, 600}; // NEC EF50AF
unsigned int  direita_sky[] = {9000, 4450, 600, 550, 600, 500, 600, 550, 550, 550, 550, 550, 650,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 1550, 650}; // NEC EFE01F
unsigned int  esquerda_sky[] = {9050, 4450, 600, 500, 600, 500, 600, 550, 600, 550, 550, 550, 600,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 1600, 600}; // NEC EFF00F
unsigned int  apps_sky[] = {9000, 4450, 600, 500, 600, 550, 600, 500, 600, 550, 600, 500, 650,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 1550, 650}; // NEC EF30CF
unsigned int  ch_mais_sky[] = {9000, 4450, 600, 500, 600, 550, 600, 550, 550, 550, 600, 500, 600,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 1650, 600}; // NEC EFBA45
unsigned int  ch_menos_sky[] = {8950, 4500, 550, 550, 600, 550, 550, 550, 600, 550, 550, 550, 600,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 1600, 600}; // NEC EFF807
unsigned int  volume_mais_sky[] = {9050, 4450, 600, 500, 600, 550, 600, 500, 600, 550, 550, 550, 650,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 1600, 600}; // NEC EF6A95
unsigned int  volume_menos_sky[] = {8950, 4450, 600, 500, 600, 500, 650, 500, 600, 500, 650, 500, 600,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 1600, 650}; // NEC EFAA55
unsigned int  usb_sky[] = {9000, 4500, 550, 550, 550, 550, 600, 550, 550, 600, 550, 500, 600,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 1600, 600}; // NEC EFA857


const char *Usuario     = "Automacao";
const char *Senha = "2020@bru";
String local = "automacoes_ir_sala"; // aqui é o local onde sera publicado

// SERVIDOR RAPSBERRY MOSQUITTO
//Coloque os valores padrÃµes aqui, porÃ©m na interface eles poderÃ£o ser substituÃ­dos.
#define servidor_mqtt             "192.168.3.186" //URL do servidor MQTT
#define servidor_mqtt_porta       "1883"  //Porta do servidor (a mesma deve ser informada na variÃ¡vel abaixo)
#define servidor_mqtt_usuario     "brunogon"  //UsuÃ¡rio
#define servidor_mqtt_senha       "268300"  //Senha
#define mqtt_topico_sub           "dev/test/minhacasa/sala/automacoes_ir_sala/comando"    //  PARA TROCAR SELECIONAR "arvore_natal" , DAR CONTROL+F E TROCAR PARA O LOCAL DESEJADO monitor_tensao_xxxx


String Mensagem_Enviar;
String topico;
char Funcoes_topico[120];
char Funcoes[100];

IPAddress staticIP(192, 168, 3, 171);
IPAddress gateway(192, 168, 3, 1);
IPAddress mascara(255, 255, 255, 0);

WiFiClient automacoes_ir_sala;                                 //Instância do WiFiClient
PubSubClient client(automacoes_ir_sala);  

ESP8266HTTPUpdateServer atualizadorOTA_automacoes_ir_sala; //Este e o objeto que permite atualizacao do programa via wifi (OTA)
ESP8266WebServer servidorWeb_automacoes_ir_sala(80); //Servidor Web na porta 80

String dispositivo = "ESP8266 Automação IR Sala";
String titulo = "Atualização via OTA - " + dispositivo;
String valor_ip = "xxx.xxx.xxx";
String condicao = "--";
String paginaWeb = "";
String mac = "";

bool primeira_mensagem = 0;

void atualizar_mensagem(char* topico, byte* mensagem, unsigned int tamanho)
{
  //Convertendo a mensagem recebida para string
  mensagem[tamanho] = '\0';
  String strMensagem = String((char*)mensagem);
  strMensagem.toLowerCase();
  //Serial.print("Chegou do MQTT: ");
  String Enviar;

  Enviar = "";
  Enviar = strMensagem;
 
  if (primeira_mensagem == 1)
  {
   readString = Enviar;
   readString.trim();
   //Ai vai voltar para o loop e la valida!

  } // Fecha primeira_mensagem = 1
  if (primeira_mensagem == 0)
  {
   primeira_mensagem = 1;
  }
  
  
  
 
  
} //fecha recebe mensagem


//Função que reconecta ao servidor MQTT
void reconectar() {
  //Repete até conectar
  while (!client.connected()) {
    //Tentativa de conectar. Se o MQTT precisa de autenticação, será chamada a função com autenticação, caso contrário, chama a sem autenticação.
    bool conectado = strlen(servidor_mqtt_usuario) > 0 ?
                     client.connect("automacoes_ir_sala", servidor_mqtt_usuario, servidor_mqtt_senha) :
                     client.connect("automacoes_ir_sala");

    if (conectado) {
      Serial.println("Conectado_MQTT,");
      client.subscribe(mqtt_topico_sub, 1); //QoS 1
    } else {
      Serial.println("Reconectando MQTT novamente em 0.2 segundos");
      
    }
  }
}


void ConectarWIFI()
{
 WiFi.mode(WIFI_STA);
 WiFi.begin(Usuario, Senha);
 WiFi.config(staticIP, gateway, mascara);
 if (WiFi.status() != WL_CONNECTED)
 {
  delay(500);
  Serial.print(".");
 }
 Serial.println("");
 Serial.println("WiFi conectado com");
 Serial.println("IP: ");
 Serial.println(WiFi.localIP());
 Serial.println("");
 valor_ip = WiFi.localIP().toString();
 mac = WiFi.macAddress();
 servidorWeb_automacoes_ir_sala.on("/", RecepcaoClienteWeb);
 
}// Fecha void ConectarWIFI



void RecepcaoClienteWeb()
{
 servidorWeb_automacoes_ir_sala.send(200, "text/html", paginaWeb);
 Pagina();
}




void Pagina()
{
 
////////////////////////////////////////////////////////////////////////////////////////////////////////////////////////////////////////////////////////////////////////////////////
// DADOS QUE SERAO EXIBIDOS NO SITE

  paginaWeb = ""
  "<!DOCTYPE html><html>"
  "<head>"
  "<title>OTA</title>"
  "<meta name='viewport' content='width=device-width, initial-scale=1.0'>"
  "<meta charset='UTF-8'>"
  "<meta http-equiv='X-UA-Compatible' content='IE=edge'>"
  "</head>"
  "<body style='margin: 20px; padding: 0px; background-color: #ADD8E6'>"
    "<h1 style='color: #00008B'>"+titulo+"</h1>"
    "<h3>IP: " + valor_ip + "</h3>"
    "<h3>MAC: " + mac + "</h3>" 
  
    "<h3>Para atualizar o sketch basta abrir <a href='http://"+valor_ip+"/update'>http://"+valor_ip+"/update</a> e pressionar enter!</h3>" 
    "<footer>Desenvolvido por Bruno Gonçalves </footer>"
  "</body>"
  
  "</html>";

////////////////////////////////////////////////////////////////////////////////////////////////////////////////////////////////////////////////////////////////////////////////////

  
  servidorWeb_automacoes_ir_sala.on("/", ChamPaginaWeb);
}//Fecha void Pagina 
void ChamPaginaWeb() {servidorWeb_automacoes_ir_sala.send(200, "text/html", paginaWeb);}



void setup()
{
  LED_Infravermelho.begin(); //INICIALIZA A FUNÇÃO
  Serial.begin(115200); //INICIALIZA A PORTA SERIAL

  ConectarWIFI();
   
  //Informando ao client do PubSub a url do servidor e a porta.
  int portaInt = atoi(servidor_mqtt_porta);
  client.setServer(servidor_mqtt, portaInt);
  client.setCallback(atualizar_mensagem);

 // Iniciar servidor atualizacao OTA
 atualizadorOTA_automacoes_ir_sala.setup(&servidorWeb_automacoes_ir_sala);
 servidorWeb_automacoes_ir_sala.begin();
}


void loop()
{
  
  while (Serial.available())
  {
    delay(3);
    char c = Serial.read();
    readString += c;
  }

  if (readString.length() > 0) // Se existir dados na serial
  {
    readString.trim(); // Não retirar esta parte, pois ela retira espaços providos a ruidos gerados
  
    // CANAIS PARA A SKY ( DUOSAT ONE NANO HD )  CANAIS PARA A SKY ( DUOSAT ONE NANO HD )  CANAIS PARA A SKY ( DUOSAT ONE NANO HD )  CANAIS PARA A SKY ( DUOSAT ONE NANO HD )  
    // CANAIS PARA A SKY ( DUOSAT ONE NANO HD )  CANAIS PARA A SKY ( DUOSAT ONE NANO HD )  CANAIS PARA A SKY ( DUOSAT ONE NANO HD )  CANAIS PARA A SKY ( DUOSAT ONE NANO HD )  
    // CANAIS PARA A SKY ( DUOSAT ONE NANO HD )  CANAIS PARA A SKY ( DUOSAT ONE NANO HD )  CANAIS PARA A SKY ( DUOSAT ONE NANO HD )  CANAIS PARA A SKY ( DUOSAT ONE NANO HD )  
    // CANAIS PARA A SKY ( DUOSAT ONE NANO HD )  CANAIS PARA A SKY ( DUOSAT ONE NANO HD )  CANAIS PARA A SKY ( DUOSAT ONE NANO HD )  CANAIS PARA A SKY ( DUOSAT ONE NANO HD )  
    // CANAIS PARA A SKY ( DUOSAT ONE NANO HD )  CANAIS PARA A SKY ( DUOSAT ONE NANO HD )  CANAIS PARA A SKY ( DUOSAT ONE NANO HD )  CANAIS PARA A SKY ( DUOSAT ONE NANO HD )  
    
    if ( readString.indexOf("sky_")>=0 &&  readString.indexOf("_sky")>=0)
    {
      int valor1 = (readString.substring(4, 5).toInt()); // Retira o primeiro algarismo do canal - Centena
      int valor2 = (readString.substring(5, 6).toInt()); // Retira o segundo algarismo do canal - Dezena
      int valor3 = (readString.substring(6, 7).toInt()); // Retira o terceiro algarismo do canal - Unidade


      //Envia duas vezes a seta pra frente para garantir que nao vai perder numero dos canais
      for(int x = 0;x<6;x++)
      {
       LED_Infravermelho.sendRaw(direita_sky, sizeof(direita_sky) / sizeof(direita_sky[0]), frequencia);
       delay(100);
      }
      
      delay(800); // Para nao embolar as setas para direita com o primeiro numero e nao perder ele!
      
      for ( int a = 0; a < 3; a++)
      { // Abre o for
        
        if ( a == 0 )
        {
          if ( valor1 == 0 )
          {
           LED_Infravermelho.sendRaw(zero_sky, sizeof(zero_sky) / sizeof(zero_sky[0]), frequencia);
           delay(100);
          }
          if ( valor1 == 1 )
          {
           LED_Infravermelho.sendRaw(um_sky, sizeof(um_sky) / sizeof(um_sky[0]), frequencia);
           delay(100);
          }
          if ( valor1 == 2 )
          {
           LED_Infravermelho.sendRaw(dois_sky, sizeof(dois_sky) / sizeof(dois_sky[0]), frequencia);
           delay(100);
          }
          if ( valor1 == 3 )
          {
           LED_Infravermelho.sendRaw(tres_sky, sizeof(tres_sky) / sizeof(tres_sky[0]), frequencia);
           delay(100);
          }
          if ( valor1 == 4 )
          {
           LED_Infravermelho.sendRaw(quatro_sky, sizeof(quatro_sky) / sizeof(quatro_sky[0]), frequencia);
           delay(100);
          }
          if ( valor1 == 5 )
          {
           LED_Infravermelho.sendRaw(cinco_sky, sizeof(cinco_sky) / sizeof(cinco_sky[0]), frequencia);
           delay(100);
          }
          if ( valor1 == 6 )
          {
           LED_Infravermelho.sendRaw(seis_sky, sizeof(seis_sky) / sizeof(seis_sky[0]), frequencia);
           delay(100);
          }
          if ( valor1 == 7 )
          {
           LED_Infravermelho.sendRaw(sete_sky, sizeof(sete_sky) / sizeof(sete_sky[0]), frequencia);
           delay(100);
          }
          if ( valor1 == 8 )
          {
           LED_Infravermelho.sendRaw(oito_sky, sizeof(oito_sky) / sizeof(oito_sky[0]), frequencia);
           delay(100);
          }
          if ( valor1 == 9 )
          {
           LED_Infravermelho.sendRaw(nove_sky, sizeof(nove_sky) / sizeof(nove_sky[0]), frequencia);
           delay(100);
          }
          

        } // Fecha se a == 0
        
        if ( a == 1 )
        {
         if ( valor2 == 0 )
          {
           LED_Infravermelho.sendRaw(zero_sky, sizeof(zero_sky) / sizeof(zero_sky[0]), frequencia);
           delay(100);
          }
          if ( valor2 == 1 )
          {
           LED_Infravermelho.sendRaw(um_sky, sizeof(um_sky) / sizeof(um_sky[0]), frequencia);
           delay(100);
          }
          if ( valor2 == 2 )
          {
           LED_Infravermelho.sendRaw(dois_sky, sizeof(dois_sky) / sizeof(dois_sky[0]), frequencia);
           delay(100);
          }
          if ( valor2 == 3 )
          {
           LED_Infravermelho.sendRaw(tres_sky, sizeof(tres_sky) / sizeof(tres_sky[0]), frequencia);
           delay(100);
          }
          if ( valor2 == 4 )
          {
           LED_Infravermelho.sendRaw(quatro_sky, sizeof(quatro_sky) / sizeof(quatro_sky[0]), frequencia);
           delay(100);
          }
          if ( valor2 == 5 )
          {
           LED_Infravermelho.sendRaw(cinco_sky, sizeof(cinco_sky) / sizeof(cinco_sky[0]), frequencia);
           delay(100);
          }
          if ( valor2 == 6 )
          {
           LED_Infravermelho.sendRaw(seis_sky, sizeof(seis_sky) / sizeof(seis_sky[0]), frequencia);
           delay(100);
          }
          if ( valor2 == 7 )
          {
           LED_Infravermelho.sendRaw(sete_sky, sizeof(sete_sky) / sizeof(sete_sky[0]), frequencia);
           delay(100);
          }
          if ( valor2 == 8 )
          {
           LED_Infravermelho.sendRaw(oito_sky, sizeof(oito_sky) / sizeof(oito_sky[0]), frequencia);
           delay(100);
          }
          if ( valor2 == 9 )
          {
           LED_Infravermelho.sendRaw(nove_sky, sizeof(nove_sky) / sizeof(nove_sky[0]), frequencia);
           delay(100);
          }


        } // Fecha se a == 1

        if ( a == 2 )
        {
          if ( valor3 == 0 )
          {
           LED_Infravermelho.sendRaw(zero_sky, sizeof(zero_sky) / sizeof(zero_sky[0]), frequencia);
           delay(100);
          }
          if ( valor3 == 1 )
          {
           LED_Infravermelho.sendRaw(um_sky, sizeof(um_sky) / sizeof(um_sky[0]), frequencia);
           delay(100);
          }
          if ( valor3 == 2 )
          {
           LED_Infravermelho.sendRaw(dois_sky, sizeof(dois_sky) / sizeof(dois_sky[0]), frequencia);
           delay(100);
          }
          if ( valor3 == 3 )
          {
           LED_Infravermelho.sendRaw(tres_sky, sizeof(tres_sky) / sizeof(tres_sky[0]), frequencia);
           delay(100);
          }
          if ( valor3 == 4 )
          {
           LED_Infravermelho.sendRaw(quatro_sky, sizeof(quatro_sky) / sizeof(quatro_sky[0]), frequencia);
           delay(100);
          }
          if ( valor3 == 5 )
          {
           LED_Infravermelho.sendRaw(cinco_sky, sizeof(cinco_sky) / sizeof(cinco_sky[0]), frequencia);
           delay(100);
          }
          if ( valor3 == 6 )
          {
           LED_Infravermelho.sendRaw(seis_sky, sizeof(seis_sky) / sizeof(seis_sky[0]), frequencia);
           delay(100);
          }
          if ( valor3 == 7 )
          {
           LED_Infravermelho.sendRaw(sete_sky, sizeof(sete_sky) / sizeof(sete_sky[0]), frequencia);
           delay(100);
          }
          if ( valor3 == 8 )
          {
           LED_Infravermelho.sendRaw(oito_sky, sizeof(oito_sky) / sizeof(oito_sky[0]), frequencia);
           delay(100);
          }
          if ( valor3 == 9 )
          {
           LED_Infravermelho.sendRaw(nove_sky, sizeof(nove_sky) / sizeof(nove_sky[0]), frequencia);
           delay(100);
          }




        } //Fecha se a == 2
      delay(100);
      } // Fecha o for
      
      // Limpa os valores
      readString = "";
      valor1 = 0;
      valor2 = 0;
      valor3 = 0;
    }
    else
    {
      
      // DADOS DA TV PHILCO  DADOS DA TV PHILCO  DADOS DA TV PHILCO  DADOS DA TV PHILCO  DADOS DA TV PHILCO  DADOS DA TV PHILCO  DADOS DA TV PHILCO  DADOS DA TV PHILCO
      // DADOS DA TV PHILCO  DADOS DA TV PHILCO  DADOS DA TV PHILCO  DADOS DA TV PHILCO  DADOS DA TV PHILCO  DADOS DA TV PHILCO  DADOS DA TV PHILCO  DADOS DA TV PHILCO
      // DADOS DA TV PHILCO  DADOS DA TV PHILCO  DADOS DA TV PHILCO  DADOS DA TV PHILCO  DADOS DA TV PHILCO  DADOS DA TV PHILCO  DADOS DA TV PHILCO  DADOS DA TV PHILCO
      // DADOS DA TV PHILCO  DADOS DA TV PHILCO  DADOS DA TV PHILCO  DADOS DA TV PHILCO  DADOS DA TV PHILCO  DADOS DA TV PHILCO  DADOS DA TV PHILCO  DADOS DA TV PHILCO
      // DADOS DA TV PHILCO  DADOS DA TV PHILCO  DADOS DA TV PHILCO  DADOS DA TV PHILCO  DADOS DA TV PHILCO  DADOS DA TV PHILCO  DADOS DA TV PHILCO  DADOS DA TV PHILCO

      if (readString == "power_tv_philco")
      {
        LED_Infravermelho.sendRaw(power_tv_philco, sizeof(power_tv_philco) / sizeof(power_tv_philco[0]), frequencia);
        delay(100);
      }
      if (readString == "volume_mais_tv_philco")
      {
        LED_Infravermelho.sendRaw(volume_mais_tv_philco, sizeof(volume_mais_tv_philco) / sizeof(volume_mais_tv_philco[0]), frequencia);
        delay(100);
      }
      if (readString == "volume_menos_tv_philco")
      {
        LED_Infravermelho.sendRaw(volume_menos_tv_philco, sizeof(volume_menos_tv_philco) / sizeof(volume_menos_tv_philco[0]), frequencia);
        delay(100);
      }


      // DADOS DA SKY  DADOS DA SKY  DADOS DA SKY  DADOS DA SKY  DADOS DA SKY  DADOS DA SKY  DADOS DA SKY  DADOS DA SKY  DADOS DA SKY  DADOS DA SKY  DADOS DA SKY  DADOS DA SKY
      // DADOS DA SKY  DADOS DA SKY  DADOS DA SKY  DADOS DA SKY  DADOS DA SKY  DADOS DA SKY  DADOS DA SKY  DADOS DA SKY  DADOS DA SKY  DADOS DA SKY  DADOS DA SKY  DADOS DA SKY
      // DADOS DA SKY  DADOS DA SKY  DADOS DA SKY  DADOS DA SKY  DADOS DA SKY  DADOS DA SKY  DADOS DA SKY  DADOS DA SKY  DADOS DA SKY  DADOS DA SKY  DADOS DA SKY  DADOS DA SKY
      // DADOS DA SKY  DADOS DA SKY  DADOS DA SKY  DADOS DA SKY  DADOS DA SKY  DADOS DA SKY  DADOS DA SKY  DADOS DA SKY  DADOS DA SKY  DADOS DA SKY  DADOS DA SKY  DADOS DA SKY
      // DADOS DA SKY  DADOS DA SKY  DADOS DA SKY  DADOS DA SKY  DADOS DA SKY  DADOS DA SKY  DADOS DA SKY  DADOS DA SKY  DADOS DA SKY  DADOS DA SKY  DADOS DA SKY  DADOS DA SKY
      // DADOS DA SKY  DADOS DA SKY  DADOS DA SKY  DADOS DA SKY  DADOS DA SKY  DADOS DA SKY  DADOS DA SKY  DADOS DA SKY  DADOS DA SKY  DADOS DA SKY  DADOS DA SKY  DADOS DA SKY

    
      if (readString == "power_sky")
      {
        LED_Infravermelho.sendNEC(0xEF3AC5, frequencia);
        delay(100);
      }
      if (readString == "mute_sky")
      {
        LED_Infravermelho.sendNEC(0xEF7887, frequencia);
        delay(100);
      }
      if (readString == "epg_sky")
      {
        LED_Infravermelho.sendNEC(0xEF30CF, frequencia);
        delay(100);
      }
      if (readString == "sair_sky")
      {
        LED_Infravermelho.sendNEC(0xEF32CD, frequencia);
        delay(100);
      }
      if (readString == "menu_sky")
      {
        LED_Infravermelho.sendNEC(0xEF08F7, frequencia);
        delay(100);
      }
      if (readString == "info_sky")
      {
        LED_Infravermelho.sendNEC(0xEF22DD, frequencia);
        delay(100);
      }
      if (readString == "cima_sky")
      {
        LED_Infravermelho.sendNEC(0xEF12ED, frequencia);
        delay(100);
      }
      if (readString == "baixo_sky")
      {
        LED_Infravermelho.sendNEC(0xEF50AF, frequencia);
        delay(100);
      }
      if (readString == "direita_sky")
      {
        LED_Infravermelho.sendNEC(0xEFE01F, frequencia);
        delay(100);
      }
      if (readString == "esquerda_sky")
      {
        LED_Infravermelho.sendNEC(0xEFF00F, frequencia);
        delay(100);
      }
      if (readString == "apps_sky")
      {
        LED_Infravermelho.sendNEC(0xEFAE51, frequencia);
        delay(100);
      }
      if (readString == "ch_mais_sky")
      {
        LED_Infravermelho.sendNEC(0xEFBA45, frequencia);
        delay(100);
      }
      if (readString == "ch_menos_sky")
      {
        LED_Infravermelho.sendNEC(0xEFF807, frequencia);
        delay(100);
      }
      if (readString == "volume_mais_sky")
      {
        LED_Infravermelho.sendNEC(0xEF6A95, frequencia);
        delay(100);
      }
      if (readString == "volume_menos_sky")
      {
        LED_Infravermelho.sendNEC(0xEFAA55, frequencia);
        delay(100);
      }
      if (readString == "ok_sky")
      {
        LED_Infravermelho.sendNEC(0xEFD02F,frequencia);
        delay(100);
      }

      // DADOS DO CLIMATIZADOR  DADOS DO CLIMATIZADOR  DADOS DO CLIMATIZADOR  DADOS DO CLIMATIZADOR  DADOS DO CLIMATIZADOR  DADOS DO CLIMATIZADOR  DADOS DO CLIMATIZADOR  DADOS DO CLIMATIZADOR
      // DADOS DO CLIMATIZADOR  DADOS DO CLIMATIZADOR  DADOS DO CLIMATIZADOR  DADOS DO CLIMATIZADOR  DADOS DO CLIMATIZADOR  DADOS DO CLIMATIZADOR  DADOS DO CLIMATIZADOR  DADOS DO CLIMATIZADOR
      // DADOS DO CLIMATIZADOR  DADOS DO CLIMATIZADOR  DADOS DO CLIMATIZADOR  DADOS DO CLIMATIZADOR  DADOS DO CLIMATIZADOR  DADOS DO CLIMATIZADOR  DADOS DO CLIMATIZADOR  DADOS DO CLIMATIZADOR
      // DADOS DO CLIMATIZADOR  DADOS DO CLIMATIZADOR  DADOS DO CLIMATIZADOR  DADOS DO CLIMATIZADOR  DADOS DO CLIMATIZADOR  DADOS DO CLIMATIZADOR  DADOS DO CLIMATIZADOR  DADOS DO CLIMATIZADOR
      // DADOS DO CLIMATIZADOR  DADOS DO CLIMATIZADOR  DADOS DO CLIMATIZADOR  DADOS DO CLIMATIZADOR  DADOS DO CLIMATIZADOR  DADOS DO CLIMATIZADOR  DADOS DO CLIMATIZADOR  DADOS DO CLIMATIZADOR
      // DADOS DO CLIMATIZADOR  DADOS DO CLIMATIZADOR  DADOS DO CLIMATIZADOR  DADOS DO CLIMATIZADOR  DADOS DO CLIMATIZADOR  DADOS DO CLIMATIZADOR  DADOS DO CLIMATIZADOR  DADOS DO CLIMATIZADOR

      if (readString == "power_ar")
      {
        LED_Infravermelho.sendRaw(power_ar, sizeof(power_ar) / sizeof(power_ar[0]), frequencia);
        delay(100);
      }

      if (readString == "umidificar_ar")
      {
        LED_Infravermelho.sendRaw(umidificar_ar, sizeof(umidificar_ar) / sizeof(umidificar_ar[0]), frequencia);
        delay(100);
      }
      if (readString == "sleep_ar")
      {
        LED_Infravermelho.sendRaw(sleep_ar, sizeof(sleep_ar) / sizeof(sleep_ar[0]), frequencia);
        delay(100);
      }
      if (readString == "velocidade_ar")
      {
        LED_Infravermelho.sendRaw(velocidade_ar, sizeof(velocidade_ar) / sizeof(velocidade_ar[0]), frequencia);
        delay(100);
      }
      if (readString == "horizontal_ar")
      {
        LED_Infravermelho.sendRaw(horizontal_ar, sizeof(horizontal_ar) / sizeof(horizontal_ar[0]), frequencia);
        delay(100);
      }
      if (readString == "vertical_ar")
      {
        LED_Infravermelho.sendRaw(vertical_ar, sizeof(vertical_ar) / sizeof(vertical_ar[0]), frequencia);
        delay(100);
      }


      // DADOS DO DENON   DADOS DO DENON   DADOS DO DENON   DADOS DO DENON   DADOS DO DENON   DADOS DO DENON   DADOS DO DENON   DADOS DO DENON   DADOS DO DENON   DADOS DO DENON
      // DADOS DO DENON   DADOS DO DENON   DADOS DO DENON   DADOS DO DENON   DADOS DO DENON   DADOS DO DENON   DADOS DO DENON   DADOS DO DENON   DADOS DO DENON   DADOS DO DENON
      // DADOS DO DENON   DADOS DO DENON   DADOS DO DENON   DADOS DO DENON   DADOS DO DENON   DADOS DO DENON   DADOS DO DENON   DADOS DO DENON   DADOS DO DENON   DADOS DO DENON
      // DADOS DO DENON   DADOS DO DENON   DADOS DO DENON   DADOS DO DENON   DADOS DO DENON   DADOS DO DENON   DADOS DO DENON   DADOS DO DENON   DADOS DO DENON   DADOS DO DENON
      // DADOS DO DENON   DADOS DO DENON   DADOS DO DENON   DADOS DO DENON   DADOS DO DENON   DADOS DO DENON   DADOS DO DENON   DADOS DO DENON   DADOS DO DENON   DADOS DO DENON
      // DADOS DO DENON   DADOS DO DENON   DADOS DO DENON   DADOS DO DENON   DADOS DO DENON   DADOS DO DENON   DADOS DO DENON   DADOS DO DENON   DADOS DO DENON   DADOS DO DENON

      if (readString == "power_denon")
      {
        LED_Infravermelho.sendRaw(power_denon, sizeof(power_denon) / sizeof(power_denon[0]), frequencia);
        delay(100);
      }
      if (readString == "sleep_denon")
      {
        LED_Infravermelho.sendRaw(sleep_denon, sizeof(sleep_denon) / sizeof(sleep_denon[0]), frequencia);
        delay(100);
      }
      if (readString == "sky_denon")
      {
        LED_Infravermelho.sendRaw(sky_denon, sizeof(sky_denon) / sizeof(sky_denon[0]), frequencia);
        delay(100);
      }

      if (readString == "dvd_denon")
      {
        LED_Infravermelho.sendRaw(dvd_denon, sizeof(dvd_denon) / sizeof(dvd_denon[0]), frequencia);
        delay(100);
      }
      if (readString == "bluray_denon")
      {
        LED_Infravermelho.sendRaw(bluray_denon, sizeof(bluray_denon) / sizeof(bluray_denon[0]), frequencia);
        delay(100);
      }

      if (readString == "ps3_denon")
      {
        LED_Infravermelho.sendRaw(ps3_denon, sizeof(ps3_denon) / sizeof(ps3_denon[0]), frequencia);
        delay(100);
      }

      if (readString == "aux1_denon")
      {
        LED_Infravermelho.sendRaw(aux1_denon, sizeof(aux1_denon) / sizeof(aux1_denon[0]), frequencia);
        delay(100);
      }

      if (readString == "mediaplayer_denon")
      {
        LED_Infravermelho.sendRaw(mediaplayer_denon, sizeof(mediaplayer_denon) / sizeof(mediaplayer_denon[0]), frequencia);
        delay(100);
      }
      if (readString == "tvaudio_denon")
      {
        LED_Infravermelho.sendRaw(tvaudio_denon, sizeof(tvaudio_denon) / sizeof(tvaudio_denon[0]), frequencia);
        delay(100);
      }

      if (readString == "aux2_denon")
      {
        LED_Infravermelho.sendRaw(aux2_denon, sizeof(aux2_denon) / sizeof(aux2_denon[0]), frequencia);
        delay(100);
      }
      if (readString == "radio_denon")
      {
        LED_Infravermelho.sendRaw(radio_denon, sizeof(radio_denon) / sizeof(radio_denon[0]), frequencia);
        delay(100);
      }
      if (readString == "usb_denon")
      {
        LED_Infravermelho.sendRaw(usb_denon, sizeof(usb_denon) / sizeof(usb_denon[0]), frequencia);
        delay(100);
      }
      if (readString == "cd_denon")
      {
        LED_Infravermelho.sendRaw(cd_denon, sizeof(cd_denon) / sizeof(cd_denon[0]), frequencia);
        delay(100);
      }
      if (readString == "bluetooth_denon")
      {
        LED_Infravermelho.sendRaw(bluetooth_denon, sizeof(bluetooth_denon) / sizeof(bluetooth_denon[0]), frequencia);
        delay(100);
      }
      if (readString == "heos_denon")
      {
        LED_Infravermelho.sendRaw(heos_denon, sizeof(heos_denon) / sizeof(heos_denon[0]), frequencia);
        delay(100);
      }

      if (readString == "mute_denon")
      {
        LED_Infravermelho.sendRaw(mute_denon, sizeof(mute_denon) / sizeof(mute_denon[0]), frequencia);
        delay(100);
      }
      if (readString == "volume_mais_denon")
      {
        LED_Infravermelho.sendRaw(volume_mais_denon, sizeof(volume_mais_denon) / sizeof(volume_mais_denon[0]), frequencia);
        delay(100);
      }
      if (readString == "volume_menos_denon")
      {
        LED_Infravermelho.sendRaw(volume_menos_denon, sizeof(volume_menos_denon) / sizeof(volume_menos_denon[0]), frequencia);
        delay(100);
      }
      if (readString == "info_denon")
      {
        LED_Infravermelho.sendRaw(info_denon, sizeof(info_denon) / sizeof(info_denon[0]), frequencia);
        delay(100);
      }
      if (readString == "option_denon")
      {
        LED_Infravermelho.sendRaw(option_denon, sizeof(option_denon) / sizeof(option_denon[0]), frequencia);
        delay(100);
      }
      if (readString == "cima_denon")
      {
        LED_Infravermelho.sendRaw(cima_denon, sizeof(cima_denon) / sizeof(cima_denon[0]), frequencia);
        delay(100);
      }
      if (readString == "baixo_denon")
      {
        LED_Infravermelho.sendRaw(baixo_denon, sizeof(baixo_denon) / sizeof(baixo_denon[0]), frequencia);
        delay(100);
      }
      if (readString == "direita_denon")
      {
        LED_Infravermelho.sendRaw(direita_denon, sizeof(direita_denon) / sizeof(direita_denon[0]), frequencia);
        delay(100);
      }
      if (readString == "direita_denon")
      {
        LED_Infravermelho.sendRaw(direita_denon, sizeof(direita_denon) / sizeof(direita_denon[0]), frequencia);
        delay(100);
      }
      if (readString == "esquerda_denon")
      {
        LED_Infravermelho.sendRaw(esquerda_denon, sizeof(esquerda_denon) / sizeof(esquerda_denon[0]), frequencia);
        delay(100);
      }
      if (readString == "setup_denon")
      {
        LED_Infravermelho.sendRaw(setup_denon, sizeof(setup_denon) / sizeof(setup_denon[0]), frequencia);
        delay(100);
      }
      if (readString == "back_denon")
      {
        LED_Infravermelho.sendRaw(back_denon, sizeof(back_denon) / sizeof(back_denon[0]), frequencia);
        delay(100);
      }
      if (readString == "tune_mais_denon")
      {
        LED_Infravermelho.sendRaw(tune_mais_denon, sizeof(tune_mais_denon) / sizeof(tune_mais_denon[0]), frequencia);
        delay(100);
      }
      if (readString == "tune_menos_denon")
      {
        LED_Infravermelho.sendRaw(tune_menos_denon, sizeof(tune_menos_denon) / sizeof(tune_menos_denon[0]), frequencia);
        delay(100);
      }
      if (readString == "play_denon")
      {
        LED_Infravermelho.sendRaw(play_denon, sizeof(play_denon) / sizeof(play_denon[0]), frequencia);
        delay(100);
      }
      if (readString == "movie_denon")
      {
        LED_Infravermelho.sendRaw(movie_denon, sizeof(movie_denon) / sizeof(movie_denon[0]), frequencia);
        delay(100);
      }
      if (readString == "music_denon")
      {
        LED_Infravermelho.sendRaw(music_denon, sizeof(music_denon) / sizeof(music_denon[0]), frequencia);
        delay(100);
      }
      if (readString == "game_denon")
      {
        LED_Infravermelho.sendRaw(game_denon, sizeof(game_denon) / sizeof(game_denon[0]), frequencia);
        delay(100);
      }
      if (readString == "pure_denon")
      {
        LED_Infravermelho.sendRaw(pure_denon, sizeof(pure_denon) / sizeof(pure_denon[0]), frequencia);
        delay(100);
      }




// PROJETOR      PROJETOR      PROJETOR      PROJETOR      PROJETOR      PROJETOR      PROJETOR      PROJETOR      PROJETOR      PROJETOR      PROJETOR      PROJETOR      PROJETOR
// PROJETOR      PROJETOR      PROJETOR      PROJETOR      PROJETOR      PROJETOR      PROJETOR      PROJETOR      PROJETOR      PROJETOR      PROJETOR      PROJETOR      PROJETOR
// PROJETOR      PROJETOR      PROJETOR      PROJETOR      PROJETOR      PROJETOR      PROJETOR      PROJETOR      PROJETOR      PROJETOR      PROJETOR      PROJETOR      PROJETOR
// PROJETOR      PROJETOR      PROJETOR      PROJETOR      PROJETOR      PROJETOR      PROJETOR      PROJETOR      PROJETOR      PROJETOR      PROJETOR      PROJETOR      PROJETOR
// PROJETOR      PROJETOR      PROJETOR      PROJETOR      PROJETOR      PROJETOR      PROJETOR      PROJETOR      PROJETOR      PROJETOR      PROJETOR      PROJETOR      PROJETOR
// PROJETOR      PROJETOR      PROJETOR      PROJETOR      PROJETOR      PROJETOR      PROJETOR      PROJETOR      PROJETOR      PROJETOR      PROJETOR      PROJETOR      PROJETOR
    if (readString == "power_projetor")
    {
     LED_Infravermelho.sendNEC(0xC1AA09F6, frequencia);
     delay(100);
    }
    if (readString == "hdmi1_projetor")
    {
     LED_Infravermelho.sendNEC(0xC1AACE31, frequencia);
     delay(100);
    }
    if (readString == "hdmi2_projetor")
    {
     LED_Infravermelho.sendNEC(0xC1AAEE11, frequencia);
     delay(100);
    }
    if (readString == "hdmi2_projetor")
    {
     LED_Infravermelho.sendNEC(0xC1AAEE11, frequencia);
     delay(100);
    }












    } // Fecha else

    readString = "";

  }// Fecha se existe dados na serial



 if (!client.connected())
 {
  reconectar(); // Para MQTT
 }

 // VERIFICA SE WIFI ESTA CONECTADO, SE ESTIVER, CHAMA ATUALIZACAO DA PAGINA OTA, SENAO, RECONECTA
 if(WiFi.status() != WL_CONNECTED) 
 {
  ConectarWIFI();
 }
 else
 {
  servidorWeb_automacoes_ir_sala.handleClient();
 }

 client.loop(); // Loop para mqtt rodar




} // Fecha Loop
