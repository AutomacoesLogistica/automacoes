/*

   CONEXÃO DO ESP8266 NODEMCU NO MQTT

   MODULO DA SALA IP 192.168.2.202

   Conexão do modulo RS485
   RO = Pino D1
   DI = Pino D2
   DE = Pino D3
   RE = Pino D3

   Lampada Status  Pino D0

   Conexão Enc28j60
   SCK = Pino D5
    SO = Pino D6
    ST = Pino D7
    CS = Pino D8 porem passando pelos mosfets canal N
   RST = Reset
   VCC = 5V
   GND = GND

  Lista de IPS do Sistema de Automação ************************************************************************************

  192.168.2.199 Central 1 Andar
  192.168.2.200 Central 3 Andar
  192.168.2.201 Supervisório
  192.168.2.202 Sala / Varanda / Acesso
  192.168.2.203 Quarto 1
  192.168.2.204 Quarto 2
  192.168.2.205 Cozinha / Banheiro Social / Corredor
  192.168.2.206 Quarto Casal / Closet / Banheiro
  192.168.2.207 Area Gourmet / Serviço
  192.168.2.208 Laboratorio

  ***************************************************************************************************************************

*/


#include <UIPEthernet.h>
#include "PubSubClient.h"
#include<SoftwareSerial.h>
#include <ArduinoOTA.h>
#include <IRremoteESP8266.h> //INCLUSÃO DE BIBLIOTECA

String readString;
IRsend LED_Infravermelho(10); //FUNÇÃO RESPONSÁVEL PELO MÉTODO DE ENVIO DO SINAL IR / UTILIZA O GPIO10(SD3)

int frequencia = 38; //FREQUÊNCIA DO SINAL IR(32KHz)

long UltimoMillis = 0;        // Variável de controle do tempo PADRAO PARA TODOS
unsigned long AtualMillis;

// VARIAVEIS PARA SLEEP DO AR *************************************************************************************************************************************
int sleep_ar_ligado = 0;
int ar_ligado = 0;
unsigned long tempo_ar;
int n_vezes_sleep_ar = 0;
int n_vezes_velocidade_ar = 0;
// ****************************************************************************************************************************************************************


// VARIAVEIS DA TV PHILCO
unsigned int  power_tv_philco[] = {8850, 4450, 550, 600, 550, 550, 500, 550, 550, 550, 550, 550, 550,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 1600, 650}; // NEC FDC03F
unsigned int  volume_mais_tv_philco[] = {8800, 4450, 500, 650, 450, 650, 450, 600, 550, 600, 500, 600, 500,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 1750, 500}; // UNKNOWN 85E09D61
unsigned int  volume_menos_tv_philco[] = {8850, 4450, 500, 600, 500, 600, 550, 550, 500, 550, 600, 550, 550,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 1700, 500}; // NEC FD58A7

// VARIAVEIS DO DENON
unsigned int  power_denon[] = {3300, 1750, 350, 500, 350, 500, 350, 1300, 400, 400, 450, 1250, 400,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 300, 500}; // UNKNOWN 9A7138C1
unsigned int  sleep_denon[] = {3300, 1700, 400, 450, 350, 500, 400, 1250, 400, 450, 400, 1250, 450,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 300, 550}; // UNKNOWN 9D036916
unsigned int  sky_denon[] = {3400, 1700, 400, 400, 450, 400, 400, 1200, 450, 450, 400, 1250, 450,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 300, 550}; // UNKNOWN 513DC322
unsigned int  dvd_denon[] = {3350, 1700, 400, 450, 350, 450, 400, 1300, 400, 400, 400, 1300, 400,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 350, 450}; // UNKNOWN 54C6DB8
unsigned int  bluray_denon[] = {3350, 1700, 400, 400, 450, 450, 350, 1300, 400, 450, 400, 1250, 400,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 400, 450}; // UNKNOWN 94176735
unsigned int  ps3_denon[] = {3350, 1700, 400, 450, 400, 400, 450, 1250, 400, 450, 400, 1250, 400,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 350, 500}; // UNKNOWN 3365CC0E
unsigned int  aux1_denon[] = {3350, 1650, 400, 450, 400, 450, 400, 1250, 400, 450, 400, 1300, 400,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 1150, 500}; // UNKNOWN AA8EAAEE
unsigned int  mediaplayer_denon[] = {3400, 1700, 400, 450, 400, 400, 450, 1200, 500, 350, 450, 1250, 400,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 300, 500}; // UNKNOWN 604FA3A2
unsigned int  tvaudio_denon[] = {3350, 1700, 450, 400, 400, 450, 350, 1300, 400, 450, 450, 1200, 400,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 450, 400}; // UNKNOWN 78372CFC
unsigned int  aux2_denon[] = {3350, 1700, 350, 450, 400, 450, 400, 1250, 400, 450, 400, 1250, 450,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 1150, 450}; // UNKNOWN BF5261A4
unsigned int  radio_denon[] = {3350, 1650, 450, 400, 400, 450, 450, 1200, 450, 400, 450, 1200, 450,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 1200, 500}; // UNKNOWN DA402832
unsigned int  usb_denon[] = {3350, 1700, 400, 450, 400, 450, 350, 1300, 400, 450, 400, 1250, 450,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 1150, 500}; // UNKNOWN 8A5679AE
unsigned int  cd_denon[] = {3300, 1750, 350, 450, 400, 450, 350, 1300, 400, 450, 350, 1350, 350,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 400, 450}; // UNKNOWN 3462E7BD
unsigned int  bluetooth_denon[] = {3300, 1700, 350, 500, 350, 450, 400, 1300, 350, 500, 350, 1300, 400,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 1200, 500}; // UNKNOWN 727E52F
unsigned int  heos_denon[] = {3300, 1700, 400, 450, 400, 450, 400, 1250, 400, 450, 450, 1200, 400,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 350, 450}; // UNKNOWN D39C58E4
unsigned int  mute_denon[] = {3350, 1650, 400, 500, 300, 500, 350, 1350, 350, 450, 400, 1250, 400,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 400, 450}; // UNKNOWN EF3858F5
unsigned int  volume_mais_denon[] = {3350, 1650, 400, 450, 400, 450, 350, 1300, 400, 450, 400, 1250, 400,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 350, 500}; // UNKNOWN 924FD4DC
unsigned int  volume_menos_denon[] = {3350, 1700, 400, 450, 400, 400, 450, 1250, 400, 400, 500, 1200, 450,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 350, 550}; // UNKNOWN FCD5027A
unsigned int  info_denon[] = {3300, 1700, 400, 450, 400, 450, 400, 1300, 400, 400, 400, 1300, 400,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 400, 450}; // UNKNOWN 31484082
unsigned int  option_denon[] = {3350, 1650, 450, 400, 450, 400, 450, 1250, 450, 350, 400, 1300, 400,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 400, 450}; // UNKNOWN F4997BEB
unsigned int  cima_denon[] = {3400, 1650, 400, 450, 400, 450, 350, 1300, 400, 450, 400, 1250, 400,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 1250, 450}; // UNKNOWN C0A735FD
unsigned int  baixo_denon[] = {3400, 1700, 400, 400, 450, 350, 450, 1250, 500, 400, 400, 1200, 450,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 1250, 400}; // UNKNOWN 4959BF04
unsigned int  direita_denon[] = {3350, 1700, 400, 400, 400, 450, 450, 1250, 400, 400, 450, 1250, 400,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 1200, 450}; // UNKNOWN 66923E3A
unsigned int  esquerda_denon[] = {3300, 1750, 350, 450, 400, 450, 400, 1300, 350, 450, 400, 1300, 350,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 1200, 450}; // UNKNOWN E34E32EB
unsigned int  setup_denon[] = {3350, 1750, 350, 400, 400, 500, 350, 1300, 350, 500, 350, 1300, 400,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 350, 450}; // UNKNOWN 3DE75718
unsigned int  back_denon[] = {3400, 1650, 400, 450, 400, 450, 400, 1250, 400, 450, 400, 1250, 450,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 350, 500}; // UNKNOWN 2A1047C0
unsigned int  tune_mais_denon[] = {3350, 1700, 400, 450, 400, 400, 400, 1300, 400, 400, 400, 1300, 450,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 350, 450}; // UNKNOWN 86ECA1B4
unsigned int  tune_menos_denon[] = {3350, 1750, 350, 450, 400, 450, 400, 1250, 400, 450, 400, 1250, 450,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 400, 400}; // UNKNOWN D56C6C87
unsigned int  play_denon[] = {3300, 1700, 400, 500, 350, 450, 400, 1250, 400, 450, 400, 1250, 450,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 300, 600}; // UNKNOWN 52213642
unsigned int  movie_denon[] = {3350, 1700, 350, 450, 400, 450, 400, 1250, 450, 400, 400, 1250, 450,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 1200, 500}; // UNKNOWN A7E802C1
unsigned int  music_denon[] = {3350, 1650, 400, 450, 400, 400, 450, 1300, 350, 450, 450, 1200, 450,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 1100, 550}; // UNKNOWN 95D7966D
unsigned int  game_denon[] = {3350, 1700, 400, 450, 350, 500, 400, 1250, 350, 500, 350, 1300, 400,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 1250, 450}; // UNKNOWN 2BEAB3F
unsigned int  pure_denon[] = {3350, 1700, 400, 400, 400, 450, 400, 1300, 400, 400, 400, 1300, 400,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 400, 450}; // UNKNOWN F1C80827


// VARIAVEIS DO AR
unsigned int  power_ar[] = {8950, 4400, 600, 550, 600, 550, 500, 600, 550, 550, 600, 600, 450,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 500, 600}; // NEC 3FA15E
unsigned int  umidificar_ar[] = {8850, 4550, 500, 550, 550, 650, 450, 600, 550, 550, 550, 650, 500,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 500, 650}; // UNKNOWN A7BE8BD2
unsigned int  sleep_ar[] = {8900, 4500, 500, 650, 500, 600, 500, 600, 550, 600, 500, 600, 500,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 550, 600}; // UNKNOWN DA89E118
unsigned int  velocidade_ar[] = {9000, 4450, 550, 600, 500, 550, 600, 550, 550, 550, 550, 600, 500,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 500, 600}; // NEC 3F21DE
unsigned int  horizontal_ar[] = {8950, 4550, 500, 600, 550, 550, 550, 600, 500, 600, 550, 550, 600,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 550, 600}; // NEC 3F41BE
unsigned int  vertical_ar[] = {9000, 4500, 550, 550, 500, 600, 550, 550, 550, 550, 600, 550, 600,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 500, 600}; // NEC 3FC13E



// VARIAVEIS DA SKY

unsigned int  power_sky[] = {9000, 4450, 600, 500, 600, 550, 550, 550, 600, 500, 650, 500, 600,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 1600, 600}; // NEC EF3AC5
unsigned int  mute_sky[] = {9000, 4450, 600, 550, 550, 550, 650, 500, 600, 500, 600, 500, 650,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 1650, 550}; // NEC EF7887
unsigned int  um_sky[] = {9050, 4400, 600, 500, 600, 550, 600, 500, 600, 500, 650, 500, 600,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 1600, 650}; // NEC EF02FD
unsigned int  dois_sky[] = {9050, 4500, 550, 550, 550, 600, 550, 550, 600, 550, 550, 550, 550,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 1650, 550}; // NEC EFC03F
unsigned int  tres_sky[] = {9050, 4450, 550, 550, 600, 550, 550, 550, 600, 550, 550, 550, 600,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 1650, 600}; // NEC EF40BF
unsigned int  quatro_sky[] = {9000, 4450, 650, 500, 550, 550, 600, 550, 550, 550, 600, 550, 600,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 1550, 600}; // NEC EF48B7
unsigned int  cinco_sky[] = {8950, 4500, 550, 550, 550, 600, 550, 550, 600, 500, 600, 550, 600,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 1600, 600}; // NEC EF6897
unsigned int  seis_sky[] = {8950, 4500, 550, 600, 550, 550, 550, 550, 600, 550, 600, 500, 600,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 1650, 600}; // NEC EF58A7
unsigned int  sete_sky[] = {8950, 4500, 550, 550, 550, 600, 600, 500, 650, 500, 550, 550, 600,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 1650, 600}; // NEC EFC837
unsigned int  oito_sky[] = {8950, 4500, 600, 550, 550, 550, 600, 550, 600, 500, 600, 500, 650,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 1600, 650}; // NEC EFE817
unsigned int  nove_sky[] = {8950, 4450, 550, 600, 550, 550, 600, 500, 600, 550, 600, 550, 550,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 1600, 600}; // NEC EFD827
unsigned int  zero_sky[] = {9000, 4450, 550, 550, 600, 500, 650, 500, 600, 500, 600, 550, 600,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 1600, 650}; // NEC EF2AD5
unsigned int  epg_sky[] = {8950, 4500, 550, 550, 550, 550, 600, 550, 600, 500, 600, 550, 600,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 1650, 650}; // NEC EF0AF5
unsigned int  sair_sky[] = {9050, 4450, 550, 550, 550, 550, 600, 550, 550, 550, 600, 500, 650,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 1500, 650}; // NEC EF38C7
unsigned int  menu_sky[] = {9000, 4450, 600, 550, 600, 550, 550, 550, 600, 500, 600, 550, 600,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 1600, 600}; // NEC EF08F7
unsigned int  info_sky[] = {8950, 4450, 550, 600, 550, 550, 550, 550, 600, 500, 650, 500, 550,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 1550, 650}; // NEC EF22DD
unsigned int  recall_sky[] = {350, 4450, 9000, 4450, 600, 550, 600, 500, 650, 500, 600, 500, 650,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 1600, 650}; // UNKNOWN 7E9B3A5D
unsigned int  cima_sky[] = {8950, 4400, 650, 450, 600, 550, 600, 500, 600, 500, 650, 500, 600,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 1550, 650}; // NEC EF12ED
unsigned int  baixo_sky[] = {8950, 4500, 650, 450, 600, 550, 600, 550, 550, 550, 600, 500, 600,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 1600, 600}; // NEC EF50AF
unsigned int  direita_sky[] = {9000, 4450, 600, 550, 600, 500, 600, 550, 550, 550, 550, 550, 650,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 1550, 650}; // NEC EFE01F
unsigned int  esquerda_sky[] = {9050, 4450, 600, 500, 600, 500, 600, 550, 600, 550, 550, 550, 600,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 1600, 600}; // NEC EFF00F
unsigned int  apps_sky[] = {9000, 4450, 600, 500, 600, 550, 600, 500, 600, 550, 600, 500, 650,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 1550, 650}; // NEC EF30CF
unsigned int  ch_mais_sky[] = {9000, 4450, 600, 500, 600, 550, 600, 550, 550, 550, 600, 500, 600,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 1650, 600}; // NEC EFBA45
unsigned int  ch_menos_sky[] = {8950, 4500, 550, 550, 600, 550, 550, 550, 600, 550, 550, 550, 600,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 1600, 600}; // NEC EFF807
unsigned int  volume_mais_sky[] = {9050, 4450, 600, 500, 600, 550, 600, 500, 600, 550, 550, 550, 650,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 1600, 600}; // NEC EF6A95
unsigned int  volume_menos_sky[] = {8950, 4450, 600, 500, 600, 500, 650, 500, 600, 500, 650, 500, 600,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 1600, 650}; // NEC EFAA55
unsigned int  usb_sky[] = {9000, 4500, 550, 550, 550, 550, 600, 550, 550, 600, 550, 500, 600,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 1600, 600}; // NEC EFA857

#define transmitir 0 // Pino DE e RE - Transmissao     PINO D3
#define pinRX 5 // Pino RO                             PINO D1
#define pinTX 4 // Pino DI                             PINO D2
SoftwareSerial RS485(pinRX, pinTX);

#define LedStatus 16 // LedStatus                      PINO D0
//202
#define MACADDRESS 0x00,0x01,0x02,0x03,0x04,0xCA
#define MYIPADDR 192,168,2,202
#define MYIPMASK 255,255,255,0
#define MYDNS 192,168,2,1
#define MYGW 192,168,2,1

// Dados para criar a conexão *******************************************************************************************************************************
uint8_t mac[6] = {MACADDRESS};
uint8_t myIP[4] = {MYIPADDR};
uint8_t myMASK[4] = {MYIPMASK};
uint8_t myDNS[4] = {MYDNS};
uint8_t myGW[4] = {MYGW};
//***********************************************************************************************************************************************************

String ValorIP = "192.168.2.202"; // Colocar o mesmo que ip, este serve para impressao via mqtt
String id = "central_sala"; // SEMPRE em minusculo
bool conectado; // Variavel para armazenar se está conectado
String MensagemParaImprimir; // Usado para enviar os dados recebidos pelo MQTT para os modulos via RS485
bool primeira_mensagem = 0;

/*
  // DADOS DO SERVIDOR DO CLOUD MQTT
  #define servidor_mqtt             "m11.cloudmqtt.com"  //URL do servidor MQTT
  #define servidor_mqtt_porta       "10671"  //Porta do servidor MQTT
  #define servidor_mqtt_usuario     "qjuidpsd"  //Usuario
  #define servidor_mqtt_senha       "bUA07u8vEsPj"  //Senha
  #define mqtt_topico_sub           "dev/test/minhacasa/sala" // Tópico do quarto1
  #define TOPICO_PUBLISH   "dev/test/minhacasa" // Tópico da central
*/


// DADOS DO SERVIDOR DO RASPBERRY MOSQUITO
#define servidor_mqtt             "192.168.2.200"  //URL do servidor MQTT
#define servidor_mqtt_porta       "1883"  //Porta do servidor MQTT
#define servidor_mqtt_usuario     "brunogon"  //Usuario
#define servidor_mqtt_senha       "268300"  //Senha
#define mqtt_topico_sub           "dev/test/minhacasa/sala" // Tópico do quarto1
#define TOPICO_PUBLISH   "dev/test/minhacasa" // Tópico da central

EthernetClient Esp8266_MQTT_sala; // Nome de cada Servidor UNICO para cada Arduino
PubSubClient client(Esp8266_MQTT_sala); // Nome de cada Servidor UNICO para cada Arduino
char MensagemRecebida[30]; // Usado para criar a string de envio dos dados recebidos pelo MQTT


//Função que será chamada ao receber mensagem do servidor MQTT
void atualizar_mensagem(char* topico, byte* mensagem, unsigned int tamanho)
{
  //Convertendo a mensagem recebida para string
  mensagem[tamanho] = '\0';
  String strMensagem = String((char*)mensagem);
  strMensagem.toLowerCase();
  digitalWrite(LedStatus, LOW); //
  delay(200);
  digitalWrite(LedStatus, HIGH); //
  if (strMensagem == id )
  {
    String DadosDaMensagemRecebida = String(id) + String(" = ") + String(ValorIP);
    DadosDaMensagemRecebida.toCharArray(MensagemRecebida, DadosDaMensagemRecebida.length() + 1);
    client.publish("dev/test/minhacasa/sala", MensagemRecebida);
    delay(250);
  }
  else
  {
     if (primeira_mensagem == 1)
    {
      MensagemParaImprimir = strMensagem;
      readString = strMensagem;
      imprimir(); //Chama o void para imprimir
    }
    if (primeira_mensagem == 0)
    {
      primeira_mensagem = 1;
    }
  }
}// Fecha o void atualizar_mensagem

void imprimir()
{
  digitalWrite(transmitir, HIGH);    //Habilita a transmissão
  String DadosDaMensagemRecebida = String(MensagemParaImprimir);
  DadosDaMensagemRecebida.toCharArray(MensagemRecebida, DadosDaMensagemRecebida.length() + 1);
  RS485.write(MensagemRecebida);
  Serial.println(MensagemRecebida);
  digitalWrite(transmitir, LOW);     //Desabilita a transmissão e volta a receber dados


}

//Função que reconecta ao servidor MQTT
void reconectar() {
  //Repete até conectar
  while (!client.connected())
  {
    conectado = strlen(servidor_mqtt_usuario) > 0 ?
                client.connect("Esp8266_MQTT_sala", servidor_mqtt_usuario, servidor_mqtt_senha) :
                client.connect("Esp8266_MQTT_sala");
    if (conectado)
    {
      digitalWrite(LedStatus, HIGH); // Ligado caso conecte no MQTT
      Serial.println("Conectado!");
      client.subscribe(mqtt_topico_sub, 1); //QoS 1 Subscreve para monitorar os comandos recebidos
      primeira_mensagem = 0;readString == "";
    }
    else
    {
      Serial.println("Tentando Reconectar!");
      digitalWrite(LedStatus, LOW); // Mantem apagado caso nao realize conexao
      delay(2000);
    }
  }
}






void setup()
{
  Serial.begin(4800);
  Ethernet.begin(mac, myIP, myDNS, myGW, myMASK);
  RS485.begin(4800);
  LED_Infravermelho.begin(); //INICIALIZA A FUNÇÃO
  pinMode(transmitir, OUTPUT);
  digitalWrite(transmitir, LOW);
  //Informando ao client do PubSub a url do servidor e a porta.
  int portaInt = atoi(servidor_mqtt_porta); // Atribui a porta utilizada no mqtt
  client.setServer(servidor_mqtt, portaInt); // Cria a conexão no servidor client conectando no servidor mqtt com porta
  client.setCallback(atualizar_mensagem); // Atualiza a ultima mensagem do servidor
  pinMode(LedStatus, OUTPUT); // Define LedMensagem como saida
  digitalWrite(LedStatus, LOW); // Inicia apagagado

  ArduinoOTA.setHostname("central_sala"); // nome que ira aparecer na rede
  // No authentication by default
  ArduinoOTA.setPassword((const char *)"sala_268300"); // Senha para permitir atualização

  ArduinoOTA.onStart([]() {
    Serial.println("Inicio...");
  });
  ArduinoOTA.onEnd([]() {
    Serial.println("nFim!");
  });
  ArduinoOTA.onProgress([](unsigned int progress, unsigned int total) {
    Serial.printf("Progresso: %u%%r", (progress / (total / 100)));
  });
  ArduinoOTA.onError([](ota_error_t error) {
    Serial.printf("Erro [%u]: ", error);
    if (error == OTA_AUTH_ERROR) Serial.println("Autenticacao Falhou");
    else if (error == OTA_BEGIN_ERROR) Serial.println("Falha no Inicio");
    else if (error == OTA_CONNECT_ERROR) Serial.println("Falha na Conexao");
    else if (error == OTA_RECEIVE_ERROR) Serial.println("Falha na Recepcao");
    else if (error == OTA_END_ERROR) Serial.println("Falha no Fim");
  });
  ArduinoOTA.begin();


}// Fecha o void setup


void atualiza_sleep_ar()
{
 tempo_ar = (tempo_ar - 60000);
 if ( tempo_ar = 0 )
 {
    int valor = tempo_ar/60000; // Para converter para min
    String DadosDaMensagemRecebida = {String(valor)+ " min"};
    DadosDaMensagemRecebida.toCharArray(MensagemRecebida, DadosDaMensagemRecebida.length() + 1);
    client.publish("dev/test/minhacasa/sala/sleep_ar_sala", MensagemRecebida);
    delay(250);

 }
 else
 {
  ar_ligado = 0;sleep_ar_ligado = 0; tempo_ar = 0;n_vezes_sleep_ar = 0;
  client.publish("dev/test/minhacasa/sala/temposelecionado_sleep_ar_sala", "Desligado");
  delay(250);  
  client.publish("dev/test/minhacasa/sala/sleep_ar_sala", "--");
  delay(250);    
 }
   




}






void loop()
{
  ArduinoOTA.handle();


  while (RS485.available())
  {
    delay(3);
    char c = RS485.read();
    readString += c;
  }

  if (readString.length() > 0 && primeira_mensagem == 1)
  {
    readString.trim(); // Não retirar esta parte, pois ela retira espaços providos a ruidos gerados
    String DadosDaMensagemRecebida = {String(readString)};
    DadosDaMensagemRecebida.toCharArray(MensagemRecebida, DadosDaMensagemRecebida.length() + 1);
    client.publish("dev/test/minhacasa", MensagemRecebida);

    // CANAIS PARA A SKY ( DUOSAT ONE NANO HD )  CANAIS PARA A SKY ( DUOSAT ONE NANO HD )  CANAIS PARA A SKY ( DUOSAT ONE NANO HD )  CANAIS PARA A SKY ( DUOSAT ONE NANO HD )
    // CANAIS PARA A SKY ( DUOSAT ONE NANO HD )  CANAIS PARA A SKY ( DUOSAT ONE NANO HD )  CANAIS PARA A SKY ( DUOSAT ONE NANO HD )  CANAIS PARA A SKY ( DUOSAT ONE NANO HD )
    // CANAIS PARA A SKY ( DUOSAT ONE NANO HD )  CANAIS PARA A SKY ( DUOSAT ONE NANO HD )  CANAIS PARA A SKY ( DUOSAT ONE NANO HD )  CANAIS PARA A SKY ( DUOSAT ONE NANO HD )
    // CANAIS PARA A SKY ( DUOSAT ONE NANO HD )  CANAIS PARA A SKY ( DUOSAT ONE NANO HD )  CANAIS PARA A SKY ( DUOSAT ONE NANO HD )  CANAIS PARA A SKY ( DUOSAT ONE NANO HD )
    // CANAIS PARA A SKY ( DUOSAT ONE NANO HD )  CANAIS PARA A SKY ( DUOSAT ONE NANO HD )  CANAIS PARA A SKY ( DUOSAT ONE NANO HD )  CANAIS PARA A SKY ( DUOSAT ONE NANO HD )

    if ( readString.indexOf("sky_") >= 0 &&  readString.indexOf("_sky") >= 0)
    {
      
      int valor1 = (readString.substring(4, 5).toInt()); // Retira o primeiro algarismo do canal - Centena
      int valor2 = (readString.substring(5, 6).toInt()); // Retira o segundo algarismo do canal - Dezena
      int valor3 = (readString.substring(6, 7).toInt()); // Retira o terceiro algarismo do canal - Unidade

      for ( int a = 0; a < 3; a++)
      { // Abre o for

        if ( a == 0 )
        {
          if ( valor1 == 0 )
          {
            LED_Infravermelho.sendRaw(zero_sky, sizeof(zero_sky) / sizeof(zero_sky[0]), frequencia);
            delay(500);
          }
          if ( valor1 == 1 )
          {
            LED_Infravermelho.sendRaw(um_sky, sizeof(um_sky) / sizeof(um_sky[0]), frequencia);
            delay(500);
          }
          if ( valor1 == 2 )
          {
            LED_Infravermelho.sendRaw(dois_sky, sizeof(dois_sky) / sizeof(dois_sky[0]), frequencia);
            delay(500);
          }
          if ( valor1 == 3 )
          {
            LED_Infravermelho.sendRaw(tres_sky, sizeof(tres_sky) / sizeof(tres_sky[0]), frequencia);
            delay(500);
          }
          if ( valor1 == 4 )
          {
            LED_Infravermelho.sendRaw(quatro_sky, sizeof(quatro_sky) / sizeof(quatro_sky[0]), frequencia);
            delay(500);
          }
          if ( valor1 == 5 )
          {
            LED_Infravermelho.sendRaw(cinco_sky, sizeof(cinco_sky) / sizeof(cinco_sky[0]), frequencia);
            delay(500);
          }
          if ( valor1 == 6 )
          {
            LED_Infravermelho.sendRaw(seis_sky, sizeof(seis_sky) / sizeof(seis_sky[0]), frequencia);
            delay(500);
          }
          if ( valor1 == 7 )
          {
            LED_Infravermelho.sendRaw(sete_sky, sizeof(sete_sky) / sizeof(sete_sky[0]), frequencia);
            delay(500);
          }
          if ( valor1 == 8 )
          {
            LED_Infravermelho.sendRaw(oito_sky, sizeof(oito_sky) / sizeof(oito_sky[0]), frequencia);
            delay(500);
          }
          if ( valor1 == 9 )
          {
            LED_Infravermelho.sendRaw(nove_sky, sizeof(nove_sky) / sizeof(nove_sky[0]), frequencia);
            delay(500);
          }


        } // Fecha se a == 0

        if ( a == 1 )
        {
          if ( valor2 == 0 )
          {
            LED_Infravermelho.sendRaw(zero_sky, sizeof(zero_sky) / sizeof(zero_sky[0]), frequencia);
            delay(500);
          }
          if ( valor2 == 1 )
          {
            LED_Infravermelho.sendRaw(um_sky, sizeof(um_sky) / sizeof(um_sky[0]), frequencia);
            delay(500);
          }
          if ( valor2 == 2 )
          {
            LED_Infravermelho.sendRaw(dois_sky, sizeof(dois_sky) / sizeof(dois_sky[0]), frequencia);
            delay(500);
          }
          if ( valor2 == 3 )
          {
            LED_Infravermelho.sendRaw(tres_sky, sizeof(tres_sky) / sizeof(tres_sky[0]), frequencia);
            delay(500);
          }
          if ( valor2 == 4 )
          {
            LED_Infravermelho.sendRaw(quatro_sky, sizeof(quatro_sky) / sizeof(quatro_sky[0]), frequencia);
            delay(500);
          }
          if ( valor2 == 5 )
          {
            LED_Infravermelho.sendRaw(cinco_sky, sizeof(cinco_sky) / sizeof(cinco_sky[0]), frequencia);
            delay(500);
          }
          if ( valor2 == 6 )
          {
            LED_Infravermelho.sendRaw(seis_sky, sizeof(seis_sky) / sizeof(seis_sky[0]), frequencia);
            delay(500);
          }
          if ( valor2 == 7 )
          {
            LED_Infravermelho.sendRaw(sete_sky, sizeof(sete_sky) / sizeof(sete_sky[0]), frequencia);
            delay(500);
          }
          if ( valor2 == 8 )
          {
            LED_Infravermelho.sendRaw(oito_sky, sizeof(oito_sky) / sizeof(oito_sky[0]), frequencia);
            delay(500);
          }
          if ( valor2 == 9 )
          {
            LED_Infravermelho.sendRaw(nove_sky, sizeof(nove_sky) / sizeof(nove_sky[0]), frequencia);
            delay(500);
          }


        } // Fecha se a == 1

        if ( a == 2 )
        {
          if ( valor3 == 0 )
          {
            LED_Infravermelho.sendRaw(zero_sky, sizeof(zero_sky) / sizeof(zero_sky[0]), frequencia);
            delay(500);
          }
          if ( valor3 == 1 )
          {
            LED_Infravermelho.sendRaw(um_sky, sizeof(um_sky) / sizeof(um_sky[0]), frequencia);
            delay(500);
          }
          if ( valor3 == 2 )
          {
            LED_Infravermelho.sendRaw(dois_sky, sizeof(dois_sky) / sizeof(dois_sky[0]), frequencia);
            delay(500);
          }
          if ( valor3 == 3 )
          {
            LED_Infravermelho.sendRaw(tres_sky, sizeof(tres_sky) / sizeof(tres_sky[0]), frequencia);
            delay(500);
          }
          if ( valor3 == 4 )
          {
            LED_Infravermelho.sendRaw(quatro_sky, sizeof(quatro_sky) / sizeof(quatro_sky[0]), frequencia);
            delay(500);
          }
          if ( valor3 == 5 )
          {
            LED_Infravermelho.sendRaw(cinco_sky, sizeof(cinco_sky) / sizeof(cinco_sky[0]), frequencia);
            delay(500);
          }
          if ( valor3 == 6 )
          {
            LED_Infravermelho.sendRaw(seis_sky, sizeof(seis_sky) / sizeof(seis_sky[0]), frequencia);
            delay(500);
          }
          if ( valor3 == 7 )
          {
            LED_Infravermelho.sendRaw(sete_sky, sizeof(sete_sky) / sizeof(sete_sky[0]), frequencia);
            delay(500);
          }
          if ( valor3 == 8 )
          {
            LED_Infravermelho.sendRaw(oito_sky, sizeof(oito_sky) / sizeof(oito_sky[0]), frequencia);
            delay(500);
          }
          if ( valor3 == 9 )
          {
            LED_Infravermelho.sendRaw(nove_sky, sizeof(nove_sky) / sizeof(nove_sky[0]), frequencia);
            delay(500);
          }




        } //Fecha se a == 2
      } // Fecha o for

      // Limpa os valores
      readString = "";
      valor1 = 0;
      valor2 = 0;
      valor3 = 0;
    }
    else
    {

      // DADOS DA TV PHILCO  DADOS DA TV PHILCO  DADOS DA TV PHILCO  DADOS DA TV PHILCO  DADOS DA TV PHILCO  DADOS DA TV PHILCO  DADOS DA TV PHILCO  DADOS DA TV PHILCO
      // DADOS DA TV PHILCO  DADOS DA TV PHILCO  DADOS DA TV PHILCO  DADOS DA TV PHILCO  DADOS DA TV PHILCO  DADOS DA TV PHILCO  DADOS DA TV PHILCO  DADOS DA TV PHILCO
      // DADOS DA TV PHILCO  DADOS DA TV PHILCO  DADOS DA TV PHILCO  DADOS DA TV PHILCO  DADOS DA TV PHILCO  DADOS DA TV PHILCO  DADOS DA TV PHILCO  DADOS DA TV PHILCO
      // DADOS DA TV PHILCO  DADOS DA TV PHILCO  DADOS DA TV PHILCO  DADOS DA TV PHILCO  DADOS DA TV PHILCO  DADOS DA TV PHILCO  DADOS DA TV PHILCO  DADOS DA TV PHILCO
      // DADOS DA TV PHILCO  DADOS DA TV PHILCO  DADOS DA TV PHILCO  DADOS DA TV PHILCO  DADOS DA TV PHILCO  DADOS DA TV PHILCO  DADOS DA TV PHILCO  DADOS DA TV PHILCO

      if (readString == "power_tv_philco")
      {
        LED_Infravermelho.sendRaw(power_tv_philco, sizeof(power_tv_philco) / sizeof(power_tv_philco[0]), frequencia);
        delay(250);
      }
      if (readString == "volume_mais_tv_philco")
      {
        LED_Infravermelho.sendRaw(volume_mais_tv_philco, sizeof(volume_mais_tv_philco) / sizeof(volume_mais_tv_philco[0]), frequencia);
        delay(250);
      }
      if (readString == "volume_menos_tv_philco")
      {
        LED_Infravermelho.sendRaw(volume_menos_tv_philco, sizeof(volume_menos_tv_philco) / sizeof(volume_menos_tv_philco[0]), frequencia);
        delay(250);
      }


      // DADOS DA SKY  DADOS DA SKY  DADOS DA SKY  DADOS DA SKY  DADOS DA SKY  DADOS DA SKY  DADOS DA SKY  DADOS DA SKY  DADOS DA SKY  DADOS DA SKY  DADOS DA SKY  DADOS DA SKY
      // DADOS DA SKY  DADOS DA SKY  DADOS DA SKY  DADOS DA SKY  DADOS DA SKY  DADOS DA SKY  DADOS DA SKY  DADOS DA SKY  DADOS DA SKY  DADOS DA SKY  DADOS DA SKY  DADOS DA SKY
      // DADOS DA SKY  DADOS DA SKY  DADOS DA SKY  DADOS DA SKY  DADOS DA SKY  DADOS DA SKY  DADOS DA SKY  DADOS DA SKY  DADOS DA SKY  DADOS DA SKY  DADOS DA SKY  DADOS DA SKY
      // DADOS DA SKY  DADOS DA SKY  DADOS DA SKY  DADOS DA SKY  DADOS DA SKY  DADOS DA SKY  DADOS DA SKY  DADOS DA SKY  DADOS DA SKY  DADOS DA SKY  DADOS DA SKY  DADOS DA SKY
      // DADOS DA SKY  DADOS DA SKY  DADOS DA SKY  DADOS DA SKY  DADOS DA SKY  DADOS DA SKY  DADOS DA SKY  DADOS DA SKY  DADOS DA SKY  DADOS DA SKY  DADOS DA SKY  DADOS DA SKY
      // DADOS DA SKY  DADOS DA SKY  DADOS DA SKY  DADOS DA SKY  DADOS DA SKY  DADOS DA SKY  DADOS DA SKY  DADOS DA SKY  DADOS DA SKY  DADOS DA SKY  DADOS DA SKY  DADOS DA SKY


      if (readString == "power_sky")
      {
        LED_Infravermelho.sendRaw(power_sky, sizeof(power_sky) / sizeof(power_sky[0]), frequencia);
        delay(250);
      }
      if (readString == "mute_sky")
      {
        LED_Infravermelho.sendRaw(mute_sky, sizeof(mute_sky) / sizeof(mute_sky[0]), frequencia);
        delay(250);
      }
      if (readString == "epg_sky")
      {
        LED_Infravermelho.sendRaw(epg_sky, sizeof(epg_sky) / sizeof(epg_sky[0]), frequencia);
        delay(250);
      }
      if (readString == "sair_sky")
      {
        LED_Infravermelho.sendRaw(sair_sky, sizeof(sair_sky) / sizeof(sair_sky[0]), frequencia);
        delay(250);
      }
      if (readString == "menu_sky")
      {
        LED_Infravermelho.sendRaw(menu_sky, sizeof(menu_sky) / sizeof(menu_sky[0]), frequencia);
        delay(250);
      }
      if (readString == "info_sky")
      {
        LED_Infravermelho.sendRaw(info_sky, sizeof(info_sky) / sizeof(info_sky[0]), frequencia);
        delay(250);
      }
      if (readString == "recall_sky")
      {
        LED_Infravermelho.sendRaw(recall_sky, sizeof(recall_sky) / sizeof(recall_sky[0]), frequencia);
        delay(250);
      }
      if (readString == "cima_sky")
      {
        LED_Infravermelho.sendRaw(cima_sky, sizeof(cima_sky) / sizeof(cima_sky[0]), frequencia);
        delay(250);
      }
      if (readString == "baixo_sky")
      {
        LED_Infravermelho.sendRaw(baixo_sky, sizeof(baixo_sky) / sizeof(baixo_sky[0]), frequencia);
        delay(250);
      }
      if (readString == "direita_sky")
      {
        LED_Infravermelho.sendRaw(direita_sky, sizeof(direita_sky) / sizeof(direita_sky[0]), frequencia);
        delay(250);
      }
      if (readString == "esquerda_sky")
      {
        LED_Infravermelho.sendRaw(esquerda_sky, sizeof(esquerda_sky) / sizeof(esquerda_sky[0]), frequencia);
        delay(250);
      }
      if (readString == "apps_sky")
      {
        LED_Infravermelho.sendRaw(apps_sky, sizeof(apps_sky) / sizeof(apps_sky[0]), frequencia);
        delay(250);
      }
      if (readString == "ch_mais_sky")
      {
        LED_Infravermelho.sendRaw(ch_mais_sky, sizeof(ch_mais_sky) / sizeof(ch_mais_sky[0]), frequencia);
        delay(250);
      }
      if (readString == "ch_menos_sky")
      {
        LED_Infravermelho.sendRaw(ch_menos_sky, sizeof(ch_menos_sky) / sizeof(ch_menos_sky[0]), frequencia);
        delay(250);
      }
      if (readString == "volume_mais_sky")
      {
        LED_Infravermelho.sendRaw(volume_mais_sky, sizeof(volume_mais_sky) / sizeof(volume_mais_sky[0]), frequencia);
        delay(250);
      }
      if (readString == "volume_menos_sky")
      {
        LED_Infravermelho.sendRaw(volume_menos_sky, sizeof(volume_menos_sky) / sizeof(volume_menos_sky[0]), frequencia);
        delay(250);
      }
      if (readString == "usb_sky")
      {
        LED_Infravermelho.sendRaw(usb_sky, sizeof(usb_sky) / sizeof(usb_sky[0]), frequencia);
        delay(250);
      }


      // DADOS DO CLIMATIZADOR  DADOS DO CLIMATIZADOR  DADOS DO CLIMATIZADOR  DADOS DO CLIMATIZADOR  DADOS DO CLIMATIZADOR  DADOS DO CLIMATIZADOR  DADOS DO CLIMATIZADOR  DADOS DO CLIMATIZADOR
      // DADOS DO CLIMATIZADOR  DADOS DO CLIMATIZADOR  DADOS DO CLIMATIZADOR  DADOS DO CLIMATIZADOR  DADOS DO CLIMATIZADOR  DADOS DO CLIMATIZADOR  DADOS DO CLIMATIZADOR  DADOS DO CLIMATIZADOR
      // DADOS DO CLIMATIZADOR  DADOS DO CLIMATIZADOR  DADOS DO CLIMATIZADOR  DADOS DO CLIMATIZADOR  DADOS DO CLIMATIZADOR  DADOS DO CLIMATIZADOR  DADOS DO CLIMATIZADOR  DADOS DO CLIMATIZADOR
      // DADOS DO CLIMATIZADOR  DADOS DO CLIMATIZADOR  DADOS DO CLIMATIZADOR  DADOS DO CLIMATIZADOR  DADOS DO CLIMATIZADOR  DADOS DO CLIMATIZADOR  DADOS DO CLIMATIZADOR  DADOS DO CLIMATIZADOR
      // DADOS DO CLIMATIZADOR  DADOS DO CLIMATIZADOR  DADOS DO CLIMATIZADOR  DADOS DO CLIMATIZADOR  DADOS DO CLIMATIZADOR  DADOS DO CLIMATIZADOR  DADOS DO CLIMATIZADOR  DADOS DO CLIMATIZADOR
      // DADOS DO CLIMATIZADOR  DADOS DO CLIMATIZADOR  DADOS DO CLIMATIZADOR  DADOS DO CLIMATIZADOR  DADOS DO CLIMATIZADOR  DADOS DO CLIMATIZADOR  DADOS DO CLIMATIZADOR  DADOS DO CLIMATIZADOR

      if (readString == "power_ar" || readString == "power_off_ar")
      {
        if(readString == "power_ar")
        {
          ar_ligado = 1;
        }
        if(readString == "power_off_ar")
        {
          ar_ligado = 0;sleep_ar_ligado = 0; tempo_ar = 0;n_vezes_sleep_ar = 0;
          client.publish("dev/test/minhacasa/sala/temposelecionado_sleep_ar_sala", "Desligado");
          delay(250);  
          client.publish("dev/test/minhacasa/sala/sleep_ar_sala", "--");
          delay(250);          
        }
        LED_Infravermelho.sendRaw(power_ar, sizeof(power_ar) / sizeof(power_ar[0]), frequencia);
        delay(250);
      }

      if (readString == "umidificar_ar" && ar_ligado == 1)
      {
        LED_Infravermelho.sendRaw(umidificar_ar, sizeof(umidificar_ar) / sizeof(umidificar_ar[0]), frequencia);
        delay(250);
      }
      if (readString == "sleep_ar" && ar_ligado == 1)
      {
        n_vezes_sleep_ar++;
        String valor;
        if (n_vezes_sleep_ar == 1){tempo_ar = (1*(3600000));valor = "1 Hora";}
        if (n_vezes_sleep_ar == 2){tempo_ar = (2*(3600000));valor = "2 Horas";}
        if (n_vezes_sleep_ar == 3){tempo_ar = (4*(3600000));valor = "4 Horas";}
        if (n_vezes_sleep_ar == 4){tempo_ar = (6*(3600000));valor = "6 Horas";}
        if (n_vezes_sleep_ar == 5){tempo_ar = (8*(3600000));valor = "8 Horas";}
        if (n_vezes_sleep_ar == 6)
        {
          tempo_ar = 0;n_vezes_sleep_ar = 0;sleep_ar_ligado = 0;valor = "Desligado";
          client.publish("dev/test/minhacasa/sala/sleep_ar_sala", "--");
          delay(250);
        }
        
        String DadosDaMensagemRecebida = {String(valor)};
        DadosDaMensagemRecebida.toCharArray(MensagemRecebida, DadosDaMensagemRecebida.length() + 1);
        client.publish("dev/test/minhacasa/sala/temposelecionado_sleep_ar_sala", MensagemRecebida);
        delay(250);
        
        LED_Infravermelho.sendRaw(sleep_ar, sizeof(sleep_ar) / sizeof(sleep_ar[0]), frequencia);
        sleep_ar_ligado = 1;
        delay(250);
      }
      if (readString == "velocidade_ar" && ar_ligado == 1)
      {
        n_vezes_velocidade_ar++;
        String valor;
        if (n_vezes_sleep_ar == 1){tempo_ar = (1*(3600000));valor = "Minimo";}
        if (n_vezes_sleep_ar == 2){tempo_ar = (2*(3600000));valor = "Médio";}
        if (n_vezes_sleep_ar == 3){tempo_ar = (4*(3600000));valor = "Máximo";}
        if (n_vezes_sleep_ar == 4){tempo_ar = (6*(3600000));valor = "Brisa";}
        if (n_vezes_sleep_ar == 5){tempo_ar = (8*(3600000));valor = "Sono Bom";}
        if (n_vezes_sleep_ar == 6)
        {
          //tempo_ar = 0;n_vezes_sleep_ar = 0;sleep_ar_ligado = 0;valor = "Desligado";
          //client.publish("dev/test/minhacasa/sala/velocidade_ar_sala", "--");
          delay(250);
        }
        
        String DadosDaMensagemRecebida = {String(valor)};
        DadosDaMensagemRecebida.toCharArray(MensagemRecebida, DadosDaMensagemRecebida.length() + 1);
        client.publish("dev/test/minhacasa/sala/temposelecionado_sleep_ar_sala", MensagemRecebida);
        delay(250);
        
        
        
        LED_Infravermelho.sendRaw(velocidade_ar, sizeof(velocidade_ar) / sizeof(velocidade_ar[0]), frequencia);
        delay(250);
      }
      if (readString == "horizontal_ar" && ar_ligado == 1)
      {
        LED_Infravermelho.sendRaw(horizontal_ar, sizeof(horizontal_ar) / sizeof(horizontal_ar[0]), frequencia);
        delay(250);
      }
      if (readString == "vertical_ar" && ar_ligado == 1)
      {
        LED_Infravermelho.sendRaw(vertical_ar, sizeof(vertical_ar) / sizeof(vertical_ar[0]), frequencia);
        delay(250);
      }


      // DADOS DO DENON   DADOS DO DENON   DADOS DO DENON   DADOS DO DENON   DADOS DO DENON   DADOS DO DENON   DADOS DO DENON   DADOS DO DENON   DADOS DO DENON   DADOS DO DENON
      // DADOS DO DENON   DADOS DO DENON   DADOS DO DENON   DADOS DO DENON   DADOS DO DENON   DADOS DO DENON   DADOS DO DENON   DADOS DO DENON   DADOS DO DENON   DADOS DO DENON
      // DADOS DO DENON   DADOS DO DENON   DADOS DO DENON   DADOS DO DENON   DADOS DO DENON   DADOS DO DENON   DADOS DO DENON   DADOS DO DENON   DADOS DO DENON   DADOS DO DENON
      // DADOS DO DENON   DADOS DO DENON   DADOS DO DENON   DADOS DO DENON   DADOS DO DENON   DADOS DO DENON   DADOS DO DENON   DADOS DO DENON   DADOS DO DENON   DADOS DO DENON
      // DADOS DO DENON   DADOS DO DENON   DADOS DO DENON   DADOS DO DENON   DADOS DO DENON   DADOS DO DENON   DADOS DO DENON   DADOS DO DENON   DADOS DO DENON   DADOS DO DENON
      // DADOS DO DENON   DADOS DO DENON   DADOS DO DENON   DADOS DO DENON   DADOS DO DENON   DADOS DO DENON   DADOS DO DENON   DADOS DO DENON   DADOS DO DENON   DADOS DO DENON

      if (readString == "power_denon")
      {
        LED_Infravermelho.sendRaw(power_denon, sizeof(power_denon) / sizeof(power_denon[0]), frequencia);
        delay(250);
      }
      if (readString == "sleep_denon")
      {
        LED_Infravermelho.sendRaw(sleep_denon, sizeof(sleep_denon) / sizeof(sleep_denon[0]), frequencia);
        delay(250);
      }
      if (readString == "sky_denon")
      {
        LED_Infravermelho.sendRaw(sky_denon, sizeof(sky_denon) / sizeof(sky_denon[0]), frequencia);
        delay(250);
      }

      if (readString == "dvd_denon")
      {
        LED_Infravermelho.sendRaw(dvd_denon, sizeof(dvd_denon) / sizeof(dvd_denon[0]), frequencia);
        delay(250);
      }
      if (readString == "bluray_denon")
      {
        LED_Infravermelho.sendRaw(bluray_denon, sizeof(bluray_denon) / sizeof(bluray_denon[0]), frequencia);
        delay(250);
      }

      if (readString == "ps3_denon")
      {
        LED_Infravermelho.sendRaw(ps3_denon, sizeof(ps3_denon) / sizeof(ps3_denon[0]), frequencia);
        delay(250);
      }

      if (readString == "aux1_denon")
      {
        LED_Infravermelho.sendRaw(aux1_denon, sizeof(aux1_denon) / sizeof(aux1_denon[0]), frequencia);
        delay(250);
      }

      if (readString == "mediaplayer_denon")
      {
        LED_Infravermelho.sendRaw(mediaplayer_denon, sizeof(mediaplayer_denon) / sizeof(mediaplayer_denon[0]), frequencia);
        delay(250);
      }
      if (readString == "tvaudio_denon")
      {
        LED_Infravermelho.sendRaw(tvaudio_denon, sizeof(tvaudio_denon) / sizeof(tvaudio_denon[0]), frequencia);
        delay(250);
      }

      if (readString == "aux2_denon")
      {
        LED_Infravermelho.sendRaw(aux2_denon, sizeof(aux2_denon) / sizeof(aux2_denon[0]), frequencia);
        delay(250);
      }
      if (readString == "radio_denon")
      {
        LED_Infravermelho.sendRaw(radio_denon, sizeof(radio_denon) / sizeof(radio_denon[0]), frequencia);
        delay(250);
      }
      if (readString == "usb_denon")
      {
        LED_Infravermelho.sendRaw(usb_denon, sizeof(usb_denon) / sizeof(usb_denon[0]), frequencia);
        delay(250);
      }
      if (readString == "cd_denon")
      {
        LED_Infravermelho.sendRaw(cd_denon, sizeof(cd_denon) / sizeof(cd_denon[0]), frequencia);
        delay(250);
      }
      if (readString == "bluetooth_denon")
      {
        LED_Infravermelho.sendRaw(bluetooth_denon, sizeof(bluetooth_denon) / sizeof(bluetooth_denon[0]), frequencia);
        delay(250);
      }
      if (readString == "heos_denon")
      {
        LED_Infravermelho.sendRaw(heos_denon, sizeof(heos_denon) / sizeof(heos_denon[0]), frequencia);
        delay(250);
      }

      if (readString == "mute_denon")
      {
        LED_Infravermelho.sendRaw(mute_denon, sizeof(mute_denon) / sizeof(mute_denon[0]), frequencia);
        delay(250);
      }
      if (readString == "volume_mais_denon")
      {
        LED_Infravermelho.sendRaw(volume_mais_denon, sizeof(volume_mais_denon) / sizeof(volume_mais_denon[0]), frequencia);
        delay(250);
      }
      if (readString == "volume_menos_denon")
      {
        LED_Infravermelho.sendRaw(volume_menos_denon, sizeof(volume_menos_denon) / sizeof(volume_menos_denon[0]), frequencia);
        delay(250);
      }
      if (readString == "info_denon")
      {
        LED_Infravermelho.sendRaw(info_denon, sizeof(info_denon) / sizeof(info_denon[0]), frequencia);
        delay(250);
      }
      if (readString == "option_denon")
      {
        LED_Infravermelho.sendRaw(option_denon, sizeof(option_denon) / sizeof(option_denon[0]), frequencia);
        delay(250);
      }
      if (readString == "cima_denon")
      {
        LED_Infravermelho.sendRaw(cima_denon, sizeof(cima_denon) / sizeof(cima_denon[0]), frequencia);
        delay(250);
      }
      if (readString == "baixo_denon")
      {
        LED_Infravermelho.sendRaw(baixo_denon, sizeof(baixo_denon) / sizeof(baixo_denon[0]), frequencia);
        delay(250);
      }
      if (readString == "direita_denon")
      {
        LED_Infravermelho.sendRaw(direita_denon, sizeof(direita_denon) / sizeof(direita_denon[0]), frequencia);
        delay(250);
      }
      if (readString == "direita_denon")
      {
        LED_Infravermelho.sendRaw(direita_denon, sizeof(direita_denon) / sizeof(direita_denon[0]), frequencia);
        delay(250);
      }
      if (readString == "esquerda_denon")
      {
        LED_Infravermelho.sendRaw(esquerda_denon, sizeof(esquerda_denon) / sizeof(esquerda_denon[0]), frequencia);
        delay(250);
      }
      if (readString == "setup_denon")
      {
        LED_Infravermelho.sendRaw(setup_denon, sizeof(setup_denon) / sizeof(setup_denon[0]), frequencia);
        delay(250);
      }
      if (readString == "back_denon")
      {
        LED_Infravermelho.sendRaw(back_denon, sizeof(back_denon) / sizeof(back_denon[0]), frequencia);
        delay(250);
      }
      if (readString == "tune_mais_denon")
      {
        LED_Infravermelho.sendRaw(tune_mais_denon, sizeof(tune_mais_denon) / sizeof(tune_mais_denon[0]), frequencia);
        delay(250);
      }
      if (readString == "tune_menos_denon")
      {
        LED_Infravermelho.sendRaw(tune_menos_denon, sizeof(tune_menos_denon) / sizeof(tune_menos_denon[0]), frequencia);
        delay(250);
      }
      if (readString == "play_denon")
      {
        LED_Infravermelho.sendRaw(play_denon, sizeof(play_denon) / sizeof(play_denon[0]), frequencia);
        delay(250);
      }
      if (readString == "movie_denon")
      {
        LED_Infravermelho.sendRaw(movie_denon, sizeof(movie_denon) / sizeof(movie_denon[0]), frequencia);
        delay(250);
      }
      if (readString == "music_denon")
      {
        LED_Infravermelho.sendRaw(music_denon, sizeof(music_denon) / sizeof(music_denon[0]), frequencia);
        delay(250);
      }
      if (readString == "game_denon")
      {
        LED_Infravermelho.sendRaw(game_denon, sizeof(game_denon) / sizeof(game_denon[0]), frequencia);
        delay(250);
      }
      if (readString == "pure_denon")
      {
        LED_Infravermelho.sendRaw(pure_denon, sizeof(pure_denon) / sizeof(pure_denon[0]), frequencia);
        delay(250);
      }


      // ATUALIZANDO VALORES AUXILIARES *************************************************************************************************************
      if (readString == "power_ar")
      {
        client.publish("dev/test/minhacasa/sala/condicao_ar_sala", "power_ar");
        delay(250);
      }
      if (readString == "power_off_ar")
      {
        client.publish("dev/test/minhacasa/sala/condicao_ar_sala", "power_off_ar");
        delay(250);
      }


      
    } // Fecha else

    // PISCA O LED DUAS VEZES CASO CHEGUE MENSAGEM PELA REDE RS485 **********************************************************************************
    digitalWrite(LedStatus, LOW); // Apaga o LED
    delay(150);
    digitalWrite(LedStatus, HIGH); // Liga o LED
    delay(150);
    digitalWrite(LedStatus, LOW); // Apaga o LED
    delay(150);
    digitalWrite(LedStatus, HIGH); // Liga o LED
    // **********************************************************************************************************************************************

    readString = "";
  } // Fecha se existe dados na serial


 
  AtualMillis = millis();    //Tempo atual em ms
  if (AtualMillis - UltimoMillis > 60000) 
  { 
   UltimoMillis = AtualMillis;    // Salva o tempo atual
   if (sleep_ar_ligado == 1){atualiza_sleep_ar();}
  }




  if (!client.connected())
  {
    reconectar(); // Caso perca a conexão entra em loop para reconectar ao MQTT
  }
  client.loop(); // Deixar essa linha pois ela que reconecta a leitura de mensagens recebidas pelo MQTT
}
